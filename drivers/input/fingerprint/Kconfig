## drivers/input/fingerprint/Kconfig
```kconfig
#
# Fingerprints driver configuration
#
menuconfig INPUT_FINGERPRINT
	bool "FingerPrints"
	help
	  Say Y here, and a list of supported fingerprints will be displayed.
	  This option doesn't affect the kernel.

	  If unsure, say Y.

if INPUT_FINGERPRINT

config FINGERPRINT_GOODIX_GF3208
        tristate "Goodix GF3208 fingerprint drvier support"
	help
          Say Y here to enable goodix fingerprint driver support

config INPUT_FPC1511_DUAL
        tristate "FPC1511 fingerprint sensor support"
        depends on SPI_MASTER

config INPUT_FPC1511
        tristate "FPC1511 fingerprint sensor support"
        depends on SPI_MASTER

config INPUT_FPC1145
        tristate "FPC1145 fingerprint sensor support"
        depends on SPI_MASTER

config INPUT_FPC1028
        tristate "FPC1028 fingerprint sensor support"
        depends on SPI_MASTER

config INPUT_FPC1028_LAOP
        bool "FPC1028 fingerprint sensor support LAOP"
        default n

config INPUT_FPC1028_XPV2
        tristate "FPC1028 fingerprint sensor support XPV2"
        depends on SPI_MASTER

config FINGERPRINT_FPS998E_ZQL1606
	tristate "FPS998E_ZQL1628"
	depends on SPI
	help
	  Say Y here if you have a 88PM860x PMIC and want to enable
	  support for the built-in touchscreen.

	  If unsure, say N.

	  To compile this driver as a module, choose M here: the
	  module will be called 88pm860x-ts

if FINGERPRINT_FPS998E_ZQL1606
config FINGERPRINT_FPS998E_ZQL1606_ID_HI
	bool "fp id pin is high"
config FINGERPRINT_FPS998E_ZQL1606_ID_LO
	bool "fp id pin is low"
endif

endif
```

## drivers/input/touchscreen/lge_oos/focaltech/Kconfig
```kconfig
#
# LGE touch core configuration
#
if INPUT_TOUCHSCREEN

menuconfig LGE_TOUCH_FOCALTECH_FT8607
	bool "LGE Touch Core ODM Device Driver - FT8607"
	depends on LGE_TOUCH_CORE_BASE
	help
	  If your device is ft8607, say Y

menuconfig LGE_TOUCH_FOCALTECH_FT8006M
	bool "LGE Touch Core ODM Device Driver - FT8006M"
	depends on LGE_TOUCH_CORE_BASE
	help
	  If your device is ft8006m, say Y

menuconfig LGE_TOUCH_FOCALTECH_FT8006P
	bool "LGE Touch Core ODM Device Driver - FT8006P"
	depends on LGE_TOUCH_CORE_BASE
	help
	  If your device is ft8006p, say Y

menuconfig LGE_TOUCH_FOCALTECH_FT8736
	bool "LGE Touch Core ODM Device Driver - FT8736"
	depends on LGE_TOUCH_CORE_BASE
	help
	  If your device is ft8736, say Y

# To Do : Focal Tech Chipseet
endif
```

## drivers/input/touchscreen/lge_oos/himax/Kconfig
```kconfig
#
# LGE touch core configuration
#
if INPUT_TOUCHSCREEN

menuconfig LGE_TOUCH_HIMAX_HX83102D
	bool "LGE Touch Core ODM Device Driver - HX83102D"
	depends on LGE_TOUCH_CORE_BASE
	help
	  If your device is hx83102d, say Y

# To Do : HIMAX Chipseet
endif
```
