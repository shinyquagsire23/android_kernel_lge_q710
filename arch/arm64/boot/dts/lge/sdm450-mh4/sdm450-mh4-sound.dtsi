/*
 * Copyright (c) 2015-2016, The Linux Foundation. All rights reserved.
 *
 * This program is free software; you can redistribute it and/or modify
 * it under the terms of the GNU General Public License version 2 and
 * only version 2 as published by the Free Software Foundation.
 *
 * This program is distributed in the hope that it will be useful,
 * but WITHOUT ANY WARRANTY; without even the implied warranty of
 * MERCHANTABILITY or FITNESS FOR A PARTICULAR PURPOSE.  See the
 * GNU General Public License for more details.
 */

&int_codec {
    qcom,msm-hs-micbias-type = "external";
    qcom,hac-pa-en = <&tlmm 8 0>;
    vdd_mic_swch-supply = <&pm8953_l10>;
    ti,tas2560;
};

&i2c_5 {
    tas2560@4c {
        status = "ok";
        compatible = "ti,tas2560";
        reg = <0x4f>;
        ti,reset-gpio = <&tlmm 59 1>;
        ti,irq-gpio = <&tlmm 60 0>;
        ti,pll = <0>;
        ti,asi-format = <0>;
        ti,load = <0>;
        ti,ppg = <0>;
    };
};
