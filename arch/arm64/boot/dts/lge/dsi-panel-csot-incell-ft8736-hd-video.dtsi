/* Copyright (c) 2013-2015, The Linux Foundation. All rights reserved.
 *
 * This program is free software; you can redistribute it and/or modify
 * it under the terms of the GNU General Public License version 2 and
 * only version 2 as published by the Free Software Foundation.
 *
 * This program is distributed in the hope that it will be useful,
 * but WITHOUT ANY WARRANTY; without even the implied warranty of
 * MERCHANTABILITY or FITNESS FOR A PARTICULAR PURPOSE.  See the
 * GNU General Public License for more details.
 */

&mdss_mdp {
	dsi_csot_incell_ft8736_hd_vid: qcom,mdss_dsi_csot_ft8736_hd_video {
		compatible = "qcom,mdss-dsi-panel";
		status = "ok";
		qcom,cont-splash-enabled;
		qcom,mdss-dsi-panel-name = "CSOT INCELL FT8736 HD video mode dsi panel";
		qcom,mdss-dsi-panel-controller = <&mdss_dsi0>;
		qcom,mdss-dsi-panel-type = "dsi_video_mode";
		qcom,mdss-dsi-panel-destination = "display_1";
		qcom,mdss-dsi-virtual-channel-id = <0>;
		qcom,mdss-dsi-stream = <0>;
		qcom,mdss-dsi-panel-framerate = <60>;
		qcom,mdss-dsi-bpp = <24>;
		qcom,mdss-dsi-panel-width = <720>;
		qcom,mdss-dsi-panel-height = <1440>;
		qcom,mdss-dsi-h-front-porch = <300>;
		qcom,mdss-dsi-h-back-porch = <90>;
		qcom,mdss-dsi-h-pulse-width = <4>;
		qcom,mdss-dsi-h-sync-skew = <0>;
		qcom,mdss-dsi-v-front-porch = <16>;
		qcom,mdss-dsi-v-back-porch = <16>;
		qcom,mdss-dsi-v-pulse-width = <2>;

		qcom,mdss-dsi-h-left-border = <0>;
		qcom,mdss-dsi-h-right-border = <0>;
		qcom,mdss-dsi-v-top-border = <0>;
		qcom,mdss-dsi-v-bottom-border = <0>;

		qcom,mdss-dsi-underflow-color = <0xff>;
		qcom,mdss-dsi-border-color = <0>;

		qcom,mdss-pan-physical-width-dimension = <64>;
		qcom,mdss-pan-physical-height-dimension = <129>;

		qcom,mdss-dsi-on-command = [
			29 01 00 00 00 00 02 00 00
			29 01 00 00 00 00 04 FF 87 36 01
			29 01 00 00 00 00 02 00 80
			29 01 00 00 00 00 03 FF 87 36
			29 01 00 00 00 00 02 00 86
			29 01 00 00 00 00 02 B0 0B
			29 01 00 00 00 00 02 00 90
			29 01 00 00 00 00 04 B3 01 00 40
			29 01 00 00 00 00 02 00 8D
			29 01 00 00 00 00 02 F5 11
			29 01 00 00 00 00 02 00 D5
			29 01 00 00 00 00 02 F5 11
			29 01 00 00 00 00 02 00 C1
			29 01 00 00 00 00 02 C0 01
			29 01 00 00 00 00 02 00 E2
			29 01 00 00 00 00 02 CE BA
			29 01 00 00 00 00 02 00 A0
			29 01 00 00 00 00 09 F3 01 00 00 00 00 00 01 03
			29 01 00 00 00 00 02 00 E4
			29 01 00 00 00 00 02 C3 40
			29 01 00 00 00 00 02 00 B0
			29 01 00 00 00 00 02 F3 01
			29 01 00 00 00 00 02 00 00
			29 01 00 00 00 00 02 1C 04
			29 01 00 00 00 00 02 00 A0
			29 01 00 00 00 00 08 B3 32 02 D0 05 A0 00 58
			29 01 00 00 00 00 02 00 80
			29 01 00 00 00 00 0F C0 00 BA 06 38 00 BA 00 BA 06 06 01 15 01 15
			29 01 00 00 00 00 02 00 80
			29 01 00 00 00 00 02 A5 CF
			29 01 00 00 00 00 02 00 90
			29 01 00 00 00 00 0F C0 00 00 01 01 01 01 01 01 03 03 31 31 09 09
			29 01 00 00 00 00 02 00 B0
			29 01 00 00 00 00 0F CE 00 01 01 01 03 31 09 00 01 01 01 03 31 09
			29 01 00 00 00 00 02 00 88
			29 01 00 00 00 00 03 C3 22 22
			29 01 00 00 00 00 02 00 98
			29 01 00 00 00 00 03 C3 22 22
			29 01 00 00 00 00 02 00 A3
			29 01 00 00 00 00 03 C1 01 10
			29 01 00 00 00 00 02 00 82
			29 01 00 00 00 00 04 A5 00 00 00
			29 01 00 00 00 00 02 00 87
			29 01 00 00 00 00 07 A5 00 07 77 00 07 07
			29 01 00 00 00 00 02 00 80
			29 01 00 00 00 00 05 C2 82 00 00 81
			29 01 00 00 00 00 02 00 84
			29 01 00 00 00 00 05 C2 81 00 00 81
			29 01 00 00 00 00 02 00 88
			29 01 00 00 00 00 05 C2 83 00 32 BC
			29 01 00 00 00 00 02 00 B0
			29 01 00 00 00 00 06 C2 82 00 00 07 88
			29 01 00 00 00 00 02 00 B5
			29 01 00 00 00 00 06 C2 81 01 00 07 88
			29 01 00 00 00 00 02 00 BA
			29 01 00 00 00 00 06 C2 00 02 00 07 88
			29 01 00 00 00 00 02 00 C0
			29 01 00 00 00 00 06 C2 01 03 00 07 88
			29 01 00 00 00 00 02 00 DA
			29 01 00 00 00 00 03 C2 33 33
			29 01 00 00 00 00 02 00 C0
			29 01 00 00 00 00 04 C3 01 99 9C
			29 01 00 00 00 00 02 00 80
			29 01 00 00 00 00 0D CC 02 03 06 07 08 09 0A 0B 0C 0D 0E 0F
			29 01 00 00 00 00 02 00 90
			29 01 00 00 00 00 0D CC 03 02 09 08 07 06 0F 0E 0D 0C 0B 0A
			29 01 00 00 00 00 02 00 A0
			29 01 00 00 00 00 10 CC 1A 1B 1C 1D 1E 1F 18 19 20 21 14 15 16 17 04
			29 01 00 00 00 00 02 00 B0
			29 01 00 00 00 00 06 CC 22 22 22 22 22
			29 01 00 00 00 00 02 00 80
			29 01 00 00 00 00 09 CB 00 00 00 00 00 00 00 00
			29 01 00 00 00 00 02 00 90
			29 01 00 00 00 00 10 CB 00 00 00 00 00 00 00 00 00 00 00 00 00 00 00
			29 01 00 00 00 00 02 00 A0
			29 01 00 00 00 00 10 CB 00 00 00 00 00 00 00 00 00 00 00 00 00 00 00
			29 01 00 00 00 00 02 00 B0
			29 01 00 00 00 00 03 CB 00 00
			29 01 00 00 00 00 02 00 C0
			29 01 00 00 00 00 10 CB 55 55 55 55 55 55 00 00 00 00 00 00 55 55 55
			29 01 00 00 00 00 02 00 D0
			29 01 00 00 00 00 10 CB 00 00 00 55 55 00 00 00 00 00 00 AA 00 00 00
			29 01 00 00 00 00 02 00 E0
			29 01 00 00 00 00 03 CB 00 00
			29 01 00 00 00 00 02 00 F0
			29 01 00 00 00 00 09 CB FF 0F 00 3F 30 30 30 00
			29 01 00 00 00 00 02 00 80
			29 01 00 00 00 00 10 CD 22 22 22 22 22 01 13 14 1B 05 03 17 18 18 22
			29 01 00 00 00 00 02 00 90
			29 01 00 00 00 00 04 CD 0F 0E 0D
			29 01 00 00 00 00 02 00 A0
			29 01 00 00 00 00 10 CD 22 22 22 22 22 02 13 14 1B 06 04 17 18 18 22
			29 01 00 00 00 00 02 00 B0
			29 01 00 00 00 00 04 CD 0F 0E 0D
			29 01 00 00 00 00 02 00 81
			29 01 00 00 00 00 0D F3 40 89 C0 40 89 C0 40 01 00 40 01 00
			29 01 00 00 00 00 02 00 80
			29 01 00 00 00 00 02 CE 93
			29 01 00 00 00 00 02 00 83
			29 01 00 00 00 00 04 CE 55 00 18
			29 01 00 00 00 00 02 00 86
			29 01 00 00 00 00 03 CE 00 00
			29 01 00 00 00 00 02 00 88
			29 01 00 00 00 00 03 CE 00 00
			29 01 00 00 00 00 02 00 8A
			29 01 00 00 00 00 03 CE 82 6A
			29 01 00 00 00 00 02 00 90
			29 01 00 00 00 00 06 CE F2 FF F6 0F FF
			29 01 00 00 00 00 02 00 F0
			29 01 00 00 00 00 07 C3 01 00 02 10 00 6A
			29 01 00 00 00 00 02 00 F7
			29 01 00 00 00 00 07 C3 02 00 30 08 00 02
			29 01 00 00 00 00 02 00 80
			29 01 00 00 00 00 0A CF 10 05 9E 00 03 05 A0 00 03
			29 01 00 00 00 00 02 00 90
			29 01 00 00 00 00 0A CF 10 03 C0 00 03 03 C2 00 03
			29 01 00 00 00 00 02 00 A0
			29 01 00 00 00 00 0A CF 10 02 60 00 03 02 62 00 03
			29 01 00 00 00 00 02 00 B0
			29 01 00 00 00 00 0A CF 10 01 40 00 03 01 42 00 03
			29 01 00 00 00 00 02 00 C0
			29 01 00 00 00 00 0A CF 11 00 00 00 03 07 80 00 03
			29 01 00 00 00 00 02 00 D0
			29 01 00 00 00 00 0A CF 10 07 6C 00 03 07 6E 00 03
			29 01 00 00 00 00 02 00 E0
			29 01 00 00 00 00 0D CF 01 00 02 02 00 31 08 00 01 10 00 6A
			29 01 00 00 00 00 02 00 E0
			29 01 00 00 00 00 02 FF 00
			29 01 00 00 00 00 02 00 90
			29 01 00 00 00 00 04 C5 77 1E 14
			29 01 00 00 00 00 02 00 89
			29 01 00 00 00 00 02 C5 05
			29 01 00 00 00 00 02 00 00
			29 01 00 00 00 00 03 D8 31 31
			29 01 00 00 00 00 02 00 00
			29 01 00 00 00 00 06 D9 80 B9 B9 B9 B9
			29 01 00 00 00 00 02 00 00
			29 01 00 00 00 00 19 E1 03 09 1A 2B 36 44 57 66 6C 76 7F 89 6E 67 64 5D 50 44 36 2C 24 18 09 06
			29 01 00 00 00 00 02 00 00
			29 01 00 00 00 00 19 E2 03 09 1A 2B 36 44 57 66 6C 76 7F 89 6E 67 64 5D 50 44 36 2C 24 18 09 06
			29 01 00 00 00 00 02 00 B3
			29 01 00 00 00 00 03 F3 02 FD
			29 01 00 00 00 00 02 00 80
			29 01 00 00 00 00 03 FF 00 00
			29 01 00 00 00 00 02 00 00
			29 01 00 00 00 00 04 FF 00 00 00
			05 01 00 00 78 00 02 11 00
			05 01 00 00 14 00 02 29 00
		];
		qcom,mdss-dsi-off-command = [
			05 01 00 00 00 00 02 28 00
			05 01 00 00 78 00 02 10 00
			29 01 00 00 00 00 02 00 00
			29 01 00 00 00 00 05 F7 5A A5 87 36
		];

		lge,mdss-dsi-extra-command-names = "lpwg-on";

		lge,mdss-dsi-extra-command-lpwg-on = [
			29 01 00 00 00 00 02 00 00
			29 01 00 00 00 00 04 FF 87 36 01
			29 01 00 00 00 00 02 00 80
			29 01 00 00 00 00 03 FF 87 36
			29 01 00 00 00 00 02 00 86
			29 01 00 00 00 00 02 B0 0B
			29 01 00 00 00 00 02 00 90
			29 01 00 00 00 00 04 B3 01 00 40
			29 01 00 00 00 00 02 00 8D
			29 01 00 00 00 00 02 F5 11
			29 01 00 00 00 00 02 00 D5
			29 01 00 00 00 00 02 F5 11
			29 01 00 00 00 00 02 00 C1
			29 01 00 00 00 00 02 C0 01
			29 01 00 00 00 00 02 00 E2
			29 01 00 00 00 00 02 CE BA
			29 01 00 00 00 00 02 00 A0
			29 01 00 00 00 00 09 F3 01 00 00 00 00 00 01 03
			29 01 00 00 00 00 02 00 E4
			29 01 00 00 00 00 02 C3 40
			29 01 00 00 00 00 02 00 B0
			29 01 00 00 00 00 02 F3 01
			29 01 00 00 00 00 02 00 00
			29 01 00 00 00 00 02 1C 04
			29 01 00 00 00 00 02 00 A0
			29 01 00 00 00 00 08 B3 32 02 D0 05 A0 00 58
			29 01 00 00 00 00 02 00 80
			29 01 00 00 00 00 0F C0 00 BA 06 38 00 BA 00 BA 06 06 01 15 01 15
			29 01 00 00 00 00 02 00 80
			29 01 00 00 00 00 02 A5 CF
			29 01 00 00 00 00 02 00 90
			29 01 00 00 00 00 0F C0 00 00 01 01 01 01 01 01 03 03 31 31 09 09
			29 01 00 00 00 00 02 00 B0
			29 01 00 00 00 00 0F CE 00 01 01 01 03 31 09 00 01 01 01 03 31 09
			29 01 00 00 00 00 02 00 88
			29 01 00 00 00 00 03 C3 22 22
			29 01 00 00 00 00 02 00 98
			29 01 00 00 00 00 03 C3 22 22
			29 01 00 00 00 00 02 00 A3
			29 01 00 00 00 00 03 C1 01 10
			29 01 00 00 00 00 02 00 82
			29 01 00 00 00 00 04 A5 00 00 00
			29 01 00 00 00 00 02 00 87
			29 01 00 00 00 00 07 A5 00 07 77 00 07 07
			29 01 00 00 00 00 02 00 80
			29 01 00 00 00 00 05 C2 82 00 00 81
			29 01 00 00 00 00 02 00 84
			29 01 00 00 00 00 05 C2 81 00 00 81
			29 01 00 00 00 00 02 00 88
			29 01 00 00 00 00 05 C2 83 00 32 BC
			29 01 00 00 00 00 02 00 B0
			29 01 00 00 00 00 06 C2 82 00 00 07 88
			29 01 00 00 00 00 02 00 B5
			29 01 00 00 00 00 06 C2 81 01 00 07 88
			29 01 00 00 00 00 02 00 BA
			29 01 00 00 00 00 06 C2 00 02 00 07 88
			29 01 00 00 00 00 02 00 C0
			29 01 00 00 00 00 06 C2 01 03 00 07 88
			29 01 00 00 00 00 02 00 DA
			29 01 00 00 00 00 03 C2 33 33
			29 01 00 00 00 00 02 00 C0
			29 01 00 00 00 00 04 C3 01 99 9C
			29 01 00 00 00 00 02 00 80
			29 01 00 00 00 00 0D CC 02 03 06 07 08 09 0A 0B 0C 0D 0E 0F
			29 01 00 00 00 00 02 00 90
			29 01 00 00 00 00 0D CC 03 02 09 08 07 06 0F 0E 0D 0C 0B 0A
			29 01 00 00 00 00 02 00 A0
			29 01 00 00 00 00 10 CC 1A 1B 1C 1D 1E 1F 18 19 20 21 14 15 16 17 04
			29 01 00 00 00 00 02 00 B0
			29 01 00 00 00 00 06 CC 22 22 22 22 22
			29 01 00 00 00 00 02 00 80
			29 01 00 00 00 00 09 CB 00 00 00 00 00 00 00 00
			29 01 00 00 00 00 02 00 90
			29 01 00 00 00 00 10 CB 00 00 00 00 00 00 00 00 00 00 00 00 00 00 00
			29 01 00 00 00 00 02 00 A0
			29 01 00 00 00 00 10 CB 00 00 00 00 00 00 00 00 00 00 00 00 00 00 00
			29 01 00 00 00 00 02 00 B0
			29 01 00 00 00 00 03 CB 00 00
			29 01 00 00 00 00 02 00 C0
			29 01 00 00 00 00 10 CB 55 55 55 55 55 55 00 00 00 00 00 00 55 55 55
			29 01 00 00 00 00 02 00 D0
			29 01 00 00 00 00 10 CB 00 00 00 55 55 00 00 00 00 00 00 AA 00 00 00
			29 01 00 00 00 00 02 00 E0
			29 01 00 00 00 00 03 CB 00 00
			29 01 00 00 00 00 02 00 F0
			29 01 00 00 00 00 09 CB FF 0F 00 3F 30 30 30 00
			29 01 00 00 00 00 02 00 80
			29 01 00 00 00 00 10 CD 22 22 22 22 22 01 13 14 1B 05 03 17 18 18 22
			29 01 00 00 00 00 02 00 90
			29 01 00 00 00 00 04 CD 0F 0E 0D
			29 01 00 00 00 00 02 00 A0
			29 01 00 00 00 00 10 CD 22 22 22 22 22 02 13 14 1B 06 04 17 18 18 22
			29 01 00 00 00 00 02 00 B0
			29 01 00 00 00 00 04 CD 0F 0E 0D
			29 01 00 00 00 00 02 00 81
			29 01 00 00 00 00 0D F3 40 89 C0 40 89 C0 40 01 00 40 01 00
			29 01 00 00 00 00 02 00 80
			29 01 00 00 00 00 02 CE 93
			29 01 00 00 00 00 02 00 83
			29 01 00 00 00 00 04 CE 55 00 18
			29 01 00 00 00 00 02 00 86
			29 01 00 00 00 00 03 CE 00 00
			29 01 00 00 00 00 02 00 88
			29 01 00 00 00 00 03 CE 00 00
			29 01 00 00 00 00 02 00 8A
			29 01 00 00 00 00 03 CE 82 6A
			29 01 00 00 00 00 02 00 90
			29 01 00 00 00 00 06 CE F2 FF F6 0F FF
			29 01 00 00 00 00 02 00 F0
			29 01 00 00 00 00 07 C3 01 00 02 10 00 6A
			29 01 00 00 00 00 02 00 F7
			29 01 00 00 00 00 07 C3 02 00 30 08 00 02
			29 01 00 00 00 00 02 00 80
			29 01 00 00 00 00 0A CF 10 05 9E 00 03 05 A0 00 03
			29 01 00 00 00 00 02 00 90
			29 01 00 00 00 00 0A CF 10 03 C0 00 03 03 C2 00 03
			29 01 00 00 00 00 02 00 A0
			29 01 00 00 00 00 0A CF 10 02 60 00 03 02 62 00 03
			29 01 00 00 00 00 02 00 B0
			29 01 00 00 00 00 0A CF 10 01 40 00 03 01 42 00 03
			29 01 00 00 00 00 02 00 C0
			29 01 00 00 00 00 0A CF 11 00 00 00 03 07 80 00 03
			29 01 00 00 00 00 02 00 D0
			29 01 00 00 00 00 0A CF 10 07 6C 00 03 07 6E 00 03
			29 01 00 00 00 00 02 00 E0
			29 01 00 00 00 00 0D CF 01 00 02 02 00 31 08 00 01 10 00 6A
			29 01 00 00 00 00 02 00 E0
			29 01 00 00 00 00 02 FF 00
			29 01 00 00 00 00 02 00 90
			29 01 00 00 00 00 04 C5 77 1E 14
			29 01 00 00 00 00 02 00 89
			29 01 00 00 00 00 02 C5 05
			29 01 00 00 00 00 02 00 00
			29 01 00 00 00 00 03 D8 31 31
			29 01 00 00 00 00 02 00 00
			29 01 00 00 00 00 06 D9 80 B9 B9 B9 B9
			29 01 00 00 00 00 02 00 00
			29 01 00 00 00 00 19 E1 03 09 1A 2B 36 44 57 66 6C 76 7F 89 6E 67 64 5D 50 44 36 2C 24 18 09 06
			29 01 00 00 00 00 02 00 00
			29 01 00 00 00 00 19 E2 03 09 1A 2B 36 44 57 66 6C 76 7F 89 6E 67 64 5D 50 44 36 2C 24 18 09 06
			29 01 00 00 00 00 02 00 B3
			29 01 00 00 00 00 03 F3 02 FD
			29 01 00 00 00 00 02 00 80
			29 01 00 00 00 00 03 FF 00 00
			29 01 00 00 00 00 02 00 00
			29 01 00 00 00 00 04 FF 00 00 00
		];

		lge,mdss-dsi-extra-command-state-lpwg-on = "dsi_lp_mode";
		qcom,mdss-dsi-on-command-state = "dsi_lp_mode";
		qcom,mdss-dsi-off-command-state = "dsi_lp_mode";

		qcom,mdss-dsi-reset-sequence = <0 5>, <1 5>, <0 5>, <1 10>;
		qcom,mdss-dsi-lp11-init;
		qcom,mdss-dsi-post-init-delay = <4>;
		qcom,mdss-dsi-h-sync-pulse = <1>;
		qcom,mdss-dsi-traffic-mode = "non_burst_sync_pulse";
		qcom,mdss-dsi-lane-map = "lane_map_0123";
		qcom,mdss-dsi-dma-trigger = "trigger_sw";
		qcom,mdss-dsi-mdp-trigger = "none";
		qcom,mdss-dsi-color-order = "rgb_swap_rgb";
		qcom,mdss-dsi-bllp-eof-power-mode;
		qcom,mdss-dsi-bllp-power-mode;
		qcom,mdss-dsi-tx-eot-append;
		qcom,mdss-dsi-lane-0-state;
		qcom,mdss-dsi-lane-1-state;
		qcom,mdss-dsi-lane-2-state;
		qcom,mdss-dsi-lane-3-state;

		qcom,mdss-dsi-panel-timings-phy-v2 = [
  			20 1C 06 07 03 03 04 a0
			20 1C 06 07 03 03 04 a0
			20 1C 06 07 03 03 04 a0
			20 1C 06 07 03 03 04 a0
			20 12 05 06 03 03 04 a0
		];
		qcom,mdss-dsi-t-clk-post = <0x0A>;
		qcom,mdss-dsi-t-clk-pre = <0x1D>;

		qcom,mdss-dsi-bl-min-level = <1>;
		qcom,mdss-dsi-bl-max-level = <255>;
		qcom,mdss-dsi-bl-pmic-control-type = "bl_ctrl_wled";

		lge,blmap-size = <256>;
		lge,blmap = <
			0	23	23	23	23	23	23	23	23	23		/* 0 ~ 9 */
			23	23	23	23	24	24	24	25	25	25		/* 10 ~ 19 */
			26	26	26	27	28	30	31	33	34	36		/* 20 ~ 29 */
			37	39	40	42	43	45	47	49	51	53		/* 30 ~ 39 */
			55	57	60	62	64	66	68	70	72	75		/* 40 ~ 49 */
			80	85	90	95	100	105	110	115	120	125		/* 50 ~ 59 */
			129	134	138	143	148	152	157	162	166	171		/* 60 ~ 69 */
			176	180	185	190	196	202	208	215	221	227		/* 70 ~ 79 */
			233	240	246	252	258	265	273	281	289	297		/* 80 ~ 89 */
			305	313	321	329	337	345	353	361	370	381		/* 90 ~ 99 */
			393	405	417	429	440	452	464	476	488	500		/* 100 ~ 109 */
			510	521	532	543	553	564	575	586	596	607		/* 110 ~ 119 */
			618	629	640	653	667	681	695	708	722	736		/* 120 ~ 129 */
			750	763	777	791	805	822	840	858	875	893		/* 130 ~ 139 */
			911	929	946	964	982	1000	1017	1034	1051	1069		/* 140 ~ 149 */
			1086	1103	1121	1138	1155	1173	1200	1207	1225	1245		/* 150 ~ 159 */
			1265	1286	1306	1327	1347	1367	1388	1408	1429	1449		/* 160 ~ 169 */
			1470	1491	1513	1534	1556	1577	1599	1620	1642	1663		/* 170 ~ 179 */
			1685	1706	1728	1750	1776	1802	1828	1855	1881	1907		/* 180 ~ 189 */
			1933	1960	1986	2012	2038	2065	2090	2116	2142	2168		/* 190 ~ 199 */
			2193	2219	2245	2271	2296	2322	2348	2374	2400	2434		/* 200 ~ 209 */
			2469	2503	2538	2572	2607	2641	2676	2710	2745	2780		/* 210 ~ 219 */
			2811	2843	2874	2906	2937	2969	3000	3032	3063	3095		/* 220 ~ 229 */
			3126	3158	3190	3227	3265	3303	3341	3379	3417	3455		/* 230 ~ 239 */
			3493	3531	3569	3607	3645	3685	3726	3767	3808	3849		/* 240 ~ 249 */
			3890	3931	3972	4013	4054	4095						/* 250 ~ 255 */
		>;
	};
};
