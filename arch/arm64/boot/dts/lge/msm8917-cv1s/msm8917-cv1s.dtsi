/*
 * Copyright (c) 2016, The Linux Foundation. All rights reserved.
 *
 * This program is free software; you can redistribute it and/or modify
 * it under the terms of the GNU General Public License version 2 and
 * only version 2 as published by the Free Software Foundation.
 *
 * This program is distributed in the hope that it will be useful,
 * but WITHOUT ANY WARRANTY; without even the implied warranty of
 * MERCHANTABILITY or FITNESS FOR A PARTICULAR PURPOSE.  See the
 * GNU General Public License for more details.
 */

#include "msm8917-cv1s-pinctrl.dtsi"
#include "msm8917-cv1s-camera.dtsi"
#include "msm8917-cv1s-panel.dtsi"
#include "msm8917-cv1s-sound.dtsi"
#include "msm8917-cv1s-misc.dtsi"
#include "msm8917-cv1s-pm.dtsi"
#include "msm8917-cv1s-touch.dtsi"
