/* Copyright (c) 2014, Code Aurora Forum. All rights reserved.
 *
 * This program is free software; you can redistribute it and/or modify
 * it under the terms of the GNU General Public License version 2 and
 * only version 2 as published by the Free Software Foundation.
 *
 * This program is distributed in the hope that it will be useful,
 * but WITHOUT ANY WARRANTY; without even the implied warranty of
 * MERCHANTABILITY or FITNESS FOR A PARTICULAR PURPOSE.  See the
 * GNU General Public License for more details.
 */

&mdss_mdp {
	dsi_innolux_vid: qcom,mdss_dsi_innolux_nt51021_wuxga_video {
		compatible = "qcom,mdss-dsi-panel";
		qcom,mdss-dsi-panel-name = "innolux NT51021 wuxga video mode panel";
		qcom,mdss-dsi-panel-controller = <&mdss_dsi0>;
		qcom,mdss-dsi-panel-type = "dsi_video_mode";
		qcom,mdss-dsi-panel-destination = "display_1";
		qcom,mdss-dsi-panel-framerate = <60>;
		qcom,mdss-dsi-virtual-channel-id = <0>;
		qcom,mdss-dsi-stream = <0>;
		qcom,mdss-dsi-panel-width = <1200>;
		qcom,mdss-dsi-panel-height = <1920>;
		qcom,mdss-dsi-h-front-porch = <96>;
		qcom,mdss-dsi-h-back-porch = <52>;
		qcom,mdss-dsi-h-pulse-width = <4>;
		qcom,mdss-dsi-h-sync-skew = <0>;
		qcom,mdss-dsi-v-back-porch = <22>;
		qcom,mdss-dsi-v-front-porch = <26>;
		qcom,mdss-dsi-v-pulse-width = <1>;
		qcom,mdss-dsi-h-left-border = <0>;
		qcom,mdss-dsi-h-right-border = <0>;
		qcom,mdss-dsi-v-top-border = <0>;
		qcom,mdss-dsi-v-bottom-border = <0>;
		qcom,mdss-dsi-bpp = <24>;
		qcom,mdss-dsi-color-order = "rgb_swap_rgb";
		qcom,mdss-dsi-underflow-color = <0xff>;
		qcom,mdss-dsi-border-color = <0>;
		qcom,cont-splash-enabled;
		qcom,mdss-dsi-force-clock-lane-hs;
		qcom,mdss-dsi-on-command = [
			15 01 00 00 00 00 02 83 00
			15 01 00 00 00 00 02 84 00
			15 01 00 00 00 00 02 8C 04
			15 01 00 00 00 00 02 83 AA
			15 01 00 00 00 00 02 84 11
			15 01 00 00 00 00 02 A9 4B

			/* cabc still image mode */
			// 15 01 00 00 00 00 02 83 BB
			// 15 01 00 00 00 00 02 84 22
			// 15 01 00 00 00 00 02 90 40
			];

		qcom,mdss-dsi-off-command = [
			15 01 00 00 01 00 02 8F A5
			05 01 00 00 00 00 02 10 00
			15 01 00 00 64 00 02 8F 00
			];
		qcom,mdss-dsi-on-command-state = "dsi_lp_mode";
		qcom,mdss-dsi-off-command-state = "dsi_hs_mode";

		lge,pre-on-cmds-delay = <30>;
		lge,pre-bl-on-delay = <100>;

		lge,panel-cmd-state-lp = "dsi_lp_mode";
		lge,panel-cmd-state-hs = "dsi_hs_mode";

		lge,mdss-dsi-extra-command-names = "mipi-mode", "i2c-mode";
		lge,mdss-dsi-extra-command-mipi-mode = [
			15 01 00 00 01 00 02 8F A5
			];
		lge,mdss-dsi-extra-command-i2c-mode = [
			15 01 00 00 64 00 02 8F 00
			];

		lge,mdss-dsi-extra-command-state-mipi-mode = "dsi_lp_mode";
		lge,mdss-dsi-extra-command-state-i2c-mode = "dsi_lp_mode";

		lge,comfort-view-cmds-state = "dsi_lp_mode";
		lge,comfort-view-cmds-off = [
			//34
			//change page1
			15 00 00 00 00 00 02 83 AA
			15 00 00 00 00 00 02 84 11
			//----R Gamma Register----
			15 00 00 00 00 00 02 C0 00
			15 00 00 00 00 00 02 C1 0F
			15 00 00 00 00 00 02 C2 17
			15 00 00 00 00 00 02 C3 23
			15 00 00 00 00 00 02 C4 32
			15 00 00 00 00 00 02 C5 3C
			15 00 00 00 00 00 02 C6 45
			15 00 00 00 00 00 02 C7 4E
			15 00 00 00 00 00 02 C8 56
			15 00 00 00 00 00 02 C9 BC
			15 00 00 00 00 00 02 CA C4
			15 00 00 00 00 00 02 CB DF
			15 00 00 00 00 00 02 CC EB
			15 00 00 00 00 00 02 CD F3
			15 00 00 00 00 00 02 CE F5
			15 00 00 00 00 00 02 CF F7
			15 00 00 00 00 00 02 D0 FD
			15 00 00 00 00 00 02 D1 11
			15 00 00 00 00 00 02 D2 25
			15 00 00 00 00 00 02 D3 46
			15 00 00 00 00 00 02 D4 4E
			15 00 00 00 00 00 02 D5 B0
			15 00 00 00 00 00 02 D6 B7
			15 00 00 00 00 00 02 D7 BF
			15 00 00 00 00 00 02 D8 C8
			15 00 00 00 00 00 02 D9 D2
			15 00 00 00 00 00 02 DA DC
			15 00 00 00 00 00 02 DB E9
			15 00 00 00 00 00 02 DC F7
			15 00 00 00 00 00 02 DD FF
			15 00 00 00 00 00 02 DE 00
			15 01 00 00 00 00 02 DF 0F

			//34
			15 00 00 00 00 00 02 E0 00
			15 00 00 00 00 00 02 E1 0F
			15 00 00 00 00 00 02 E2 17
			15 00 00 00 00 00 02 E3 23
			15 00 00 00 00 00 02 E4 32
			15 00 00 00 00 00 02 E5 3C
			15 00 00 00 00 00 02 E6 45
			15 00 00 00 00 00 02 E7 4E
			15 00 00 00 00 00 02 E8 56
			15 00 00 00 00 00 02 E9 BC
			15 00 00 00 00 00 02 EA C4
			15 00 00 00 00 00 02 EB DF
			15 00 00 00 00 00 02 EC EB
			15 00 00 00 00 00 02 ED F3
			15 00 00 00 00 00 02 EE F5
			15 00 00 00 00 00 02 EF F7
			15 00 00 00 00 00 02 F0 FD
			15 00 00 00 00 00 02 F1 11
			15 00 00 00 00 00 02 F2 25
			15 00 00 00 00 00 02 F3 46
			15 00 00 00 00 00 02 F4 4E
			15 00 00 00 00 00 02 F5 B0
			15 00 00 00 00 00 02 F6 B7
			15 00 00 00 00 00 02 F7 BF
			15 00 00 00 00 00 02 F8 C8
			15 00 00 00 00 00 02 F9 D2
			15 00 00 00 00 00 02 FA DC
			15 00 00 00 00 00 02 FB E9
			15 00 00 00 00 00 02 FC F7
			15 00 00 00 00 00 02 FD FF
			15 00 00 00 00 00 02 FE 00
			15 00 00 00 00 00 02 FF 0F
			//change page 2
			15 00 00 00 00 00 02 83 BB
			15 01 00 00 00 00 02 84 22
			//----G Gamma Register----
			//32
			15 00 00 00 00 00 02 C0 00
			15 00 00 00 00 00 02 C1 0A
			15 00 00 00 00 00 02 C2 16
			15 00 00 00 00 00 02 C3 22
			15 00 00 00 00 00 02 C4 2E
			15 00 00 00 00 00 02 C5 3A
			15 00 00 00 00 00 02 C6 44
			15 00 00 00 00 00 02 C7 4D
			15 00 00 00 00 00 02 C8 55
			15 00 00 00 00 00 02 C9 BA
			15 00 00 00 00 00 02 CA C1
			15 00 00 00 00 00 02 CB DF
			15 00 00 00 00 00 02 CC EB
			15 00 00 00 00 00 02 CD F3
			15 00 00 00 00 00 02 CE F6
			15 00 00 00 00 00 02 CF F8
			15 00 00 00 00 00 02 D0 FE
			15 00 00 00 00 00 02 D1 13
			15 00 00 00 00 00 02 D2 27
			15 00 00 00 00 00 02 D3 48
			15 00 00 00 00 00 02 D4 51
			15 00 00 00 00 00 02 D5 B1
			15 00 00 00 00 00 02 D6 B9
			15 00 00 00 00 00 02 D7 C1
			15 00 00 00 00 00 02 D8 C9
			15 00 00 00 00 00 02 D9 D2
			15 00 00 00 00 00 02 DA DD
			15 00 00 00 00 00 02 DB E9
			15 00 00 00 00 00 02 DC F7
			15 00 00 00 00 00 02 DD FF
			15 00 00 00 00 00 02 DE 00
			15 01 00 00 00 00 02 DF 0F
			//34
			15 00 00 00 00 00 02 E0 00
			15 00 00 00 00 00 02 E1 0A
			15 00 00 00 00 00 02 E2 16
			15 00 00 00 00 00 02 E3 22
			15 00 00 00 00 00 02 E4 2E
			15 00 00 00 00 00 02 E5 3A
			15 00 00 00 00 00 02 E6 44
			15 00 00 00 00 00 02 E7 4D
			15 00 00 00 00 00 02 E8 55
			15 00 00 00 00 00 02 E9 BA
			15 00 00 00 00 00 02 EA C1
			15 00 00 00 00 00 02 EB DF
			15 00 00 00 00 00 02 EC EB
			15 00 00 00 00 00 02 ED F3
			15 00 00 00 00 00 02 EE F6
			15 00 00 00 00 00 02 EF F8
			15 00 00 00 00 00 02 F0 FE
			15 00 00 00 00 00 02 F1 13
			15 00 00 00 00 00 02 F2 27
			15 00 00 00 00 00 02 F3 48
			15 00 00 00 00 00 02 F4 51
			15 00 00 00 00 00 02 F5 B1
			15 00 00 00 00 00 02 F6 B9
			15 00 00 00 00 00 02 F7 C1
			15 00 00 00 00 00 02 F8 C9
			15 00 00 00 00 00 02 F9 D2
			15 00 00 00 00 00 02 FA DD
			15 00 00 00 00 00 02 FB E9
			15 00 00 00 00 00 02 FC F7
			15 00 00 00 00 00 02 FD FF
			15 00 00 00 00 00 02 FE 00
			15 00 00 00 00 00 02 FF 0F
			//change page 3
			15 00 00 00 00 00 02 83 CC
			15 01 00 00 00 00 02 84 33
			//----B Gamma Register----
			//32
			15 00 00 00 00 00 02 C0 00
			15 00 00 00 00 00 02 C1 0B
			15 00 00 00 00 00 02 C2 12
			15 00 00 00 00 00 02 C3 15
			15 00 00 00 00 00 02 C4 22
			15 00 00 00 00 00 02 C5 31
			15 00 00 00 00 00 02 C6 3D
			15 00 00 00 00 00 02 C7 48
			15 00 00 00 00 00 02 C8 51
			15 00 00 00 00 00 02 C9 B7
			15 00 00 00 00 00 02 CA C0
			15 00 00 00 00 00 02 CB DE
			15 00 00 00 00 00 02 CC EB
			15 00 00 00 00 00 02 CD F4
			15 00 00 00 00 00 02 CE F8
			15 00 00 00 00 00 02 CF FA
			15 00 00 00 00 00 02 D0 01
			15 00 00 00 00 00 02 D1 17
			15 00 00 00 00 00 02 D2 2C
			15 00 00 00 00 00 02 D3 4C
			15 00 00 00 00 00 02 D4 54
			15 00 00 00 00 00 02 D5 B1
			15 00 00 00 00 00 02 D6 B8
			15 00 00 00 00 00 02 D7 C0
			15 00 00 00 00 00 02 D8 C7
			15 00 00 00 00 00 02 D9 D0
			15 00 00 00 00 00 02 DA D9
			15 00 00 00 00 00 02 DB E3
			15 00 00 00 00 00 02 DC EF
			15 00 00 00 00 00 02 DD F5
			15 00 00 00 00 00 02 DE 80
			15 01 00 00 00 00 02 DF 0F

			//32
			15 00 00 00 00 00 02 E0 00
			15 00 00 00 00 00 02 E1 0B
			15 00 00 00 00 00 02 E2 12
			15 00 00 00 00 00 02 E3 15
			15 00 00 00 00 00 02 E4 22
			15 00 00 00 00 00 02 E5 31
			15 00 00 00 00 00 02 E6 3D
			15 00 00 00 00 00 02 E7 48
			15 00 00 00 00 00 02 E8 51
			15 00 00 00 00 00 02 E9 B7
			15 00 00 00 00 00 02 EA C0
			15 00 00 00 00 00 02 EB DE
			15 00 00 00 00 00 02 EC EB
			15 00 00 00 00 00 02 ED F4
			15 00 00 00 00 00 02 EE F8
			15 00 00 00 00 00 02 EF FA
			15 00 00 00 00 00 02 F0 01
			15 00 00 00 00 00 02 F1 17
			15 00 00 00 00 00 02 F2 2C
			15 00 00 00 00 00 02 F3 4C
			15 00 00 00 00 00 02 F4 54
			15 00 00 00 00 00 02 F5 B1
			15 00 00 00 00 00 02 F6 B8
			15 00 00 00 00 00 02 F7 C0
			15 00 00 00 00 00 02 F8 C7
			15 00 00 00 00 00 02 F9 D0
			15 00 00 00 00 00 02 FA D9
			15 00 00 00 00 00 02 FB E3
			15 00 00 00 00 00 02 FC EF
			15 00 00 00 00 00 02 FD F5
			15 00 00 00 00 00 02 FE 80
			15 01 00 00 00 00 02 FF 0F
			];
		lge,comfort-view-cmds-step1 = [
			// 34
			15 00 00 00 00 00 02 83 AA
			15 00 00 00 00 00 02 84 11
			//----R Gamma Register----
			15 00 00 00 00 00 02 C0 00
			15 00 00 00 00 00 02 C1 01
			15 00 00 00 00 00 02 C2 08
			15 00 00 00 00 00 02 C3 12
			15 00 00 00 00 00 02 C4 1C
			15 00 00 00 00 00 02 C5 28
			15 00 00 00 00 00 02 C6 32
			15 00 00 00 00 00 02 C7 3B
			15 00 00 00 00 00 02 C8 44
			15 00 00 00 00 00 02 C9 9A
			15 00 00 00 00 00 02 CA A4
			15 00 00 00 00 00 02 CB BF
			15 00 00 00 00 00 02 CC CF
			15 00 00 00 00 00 02 CD DA
			15 00 00 00 00 00 02 CE DE
			15 00 00 00 00 00 02 CF E0
			15 00 00 00 00 00 02 D0 E8
			15 00 00 00 00 00 02 D1 FD
			15 00 00 00 00 00 02 D2 13
			15 00 00 00 00 00 02 D3 35
			15 00 00 00 00 00 02 D4 40
			15 00 00 00 00 00 02 D5 AA
			15 00 00 00 00 00 02 D6 B2
			15 00 00 00 00 00 02 D7 BB
			15 00 00 00 00 00 02 D8 C2
			15 00 00 00 00 00 02 D9 CD
			15 00 00 00 00 00 02 DA D9
			15 00 00 00 00 00 02 DB E6
			15 00 00 00 00 00 02 DC FB
			15 00 00 00 00 00 02 DD FF
			15 00 00 00 00 00 02 DE 00
			15 01 00 00 00 00 02 DF 0E
			//34
			15 00 00 00 00 00 02 E0 00
			15 00 00 00 00 00 02 E1 01
			15 00 00 00 00 00 02 E2 08
			15 00 00 00 00 00 02 E3 12
			15 00 00 00 00 00 02 E4 1C
			15 00 00 00 00 00 02 E5 28
			15 00 00 00 00 00 02 E6 32
			15 00 00 00 00 00 02 E7 3B
			15 00 00 00 00 00 02 E8 44
			15 00 00 00 00 00 02 E9 9A
			15 00 00 00 00 00 02 EA A4
			15 00 00 00 00 00 02 EB BF
			15 00 00 00 00 00 02 EC CF
			15 00 00 00 00 00 02 ED DA
			15 00 00 00 00 00 02 EE DE
			15 00 00 00 00 00 02 EF E0
			15 00 00 00 00 00 02 F0 E8
			15 00 00 00 00 00 02 F1 FD
			15 00 00 00 00 00 02 F2 13
			15 00 00 00 00 00 02 F3 35
			15 00 00 00 00 00 02 F4 40
			15 00 00 00 00 00 02 F5 AA
			15 00 00 00 00 00 02 F6 B2
			15 00 00 00 00 00 02 F7 BB
			15 00 00 00 00 00 02 F8 C2
			15 00 00 00 00 00 02 F9 CD
			15 00 00 00 00 00 02 FA D9
			15 00 00 00 00 00 02 FB E6
			15 00 00 00 00 00 02 FC FB
			15 00 00 00 00 00 02 FD FF
			15 00 00 00 00 00 02 FE 00
			15 00 00 00 00 00 02 FF 0E
			//----G Gamma Registe G
			15 00 00 00 00 00 02 83 BB
			15 01 00 00 00 00 02 84 22
			//----G Gamma Registe G
			//32
			15 00 00 00 00 00 02 C0 00
			15 00 00 00 00 00 02 C1 0C
			15 00 00 00 00 00 02 C2 10
			15 00 00 00 00 00 02 C3 17
			15 00 00 00 00 00 02 C4 1E
			15 00 00 00 00 00 02 C5 26
			15 00 00 00 00 00 02 C6 2F
			15 00 00 00 00 00 02 C7 38
			15 00 00 00 00 00 02 C8 40
			15 00 00 00 00 00 02 C9 95
			15 00 00 00 00 00 02 CA 9C
			15 00 00 00 00 00 02 CB BC
			15 00 00 00 00 00 02 CC CC
			15 00 00 00 00 00 02 CD D7
			15 00 00 00 00 00 02 CE DA
			15 00 00 00 00 00 02 CF DC
			15 00 00 00 00 00 02 D0 E3
			15 00 00 00 00 00 02 D1 F7
			15 00 00 00 00 00 02 D2 0A
			15 00 00 00 00 00 02 D3 29
			15 00 00 00 00 00 02 D4 2F
			15 00 00 00 00 00 02 D5 9E
			15 00 00 00 00 00 02 D6 A5
			15 00 00 00 00 00 02 D7 AC
			15 00 00 00 00 00 02 D8 B4
			15 00 00 00 00 00 02 D9 BC
			15 00 00 00 00 00 02 DA C5
			15 00 00 00 00 00 02 DB CF
			15 00 00 00 00 00 02 DC D9
			15 00 00 00 00 00 02 DD E0
			15 00 00 00 00 00 02 DE 00
			15 01 00 00 00 00 02 DF 0E
			//34
			15 00 00 00 00 00 02 E0 00
			15 00 00 00 00 00 02 E1 0C
			15 00 00 00 00 00 02 E2 10
			15 00 00 00 00 00 02 E3 17
			15 00 00 00 00 00 02 E4 1E
			15 00 00 00 00 00 02 E5 26
			15 00 00 00 00 00 02 E6 2F
			15 00 00 00 00 00 02 E7 38
			15 00 00 00 00 00 02 E8 40
			15 00 00 00 00 00 02 E9 95
			15 00 00 00 00 00 02 EA 9C
			15 00 00 00 00 00 02 EB BC
			15 00 00 00 00 00 02 EC CC
			15 00 00 00 00 00 02 ED D7
			15 00 00 00 00 00 02 EE DA
			15 00 00 00 00 00 02 EF DC
			15 00 00 00 00 00 02 F0 E3
			15 00 00 00 00 00 02 F1 F7
			15 00 00 00 00 00 02 F2 0A
			15 00 00 00 00 00 02 F3 29
			15 00 00 00 00 00 02 F4 2F
			15 00 00 00 00 00 02 F5 9E
			15 00 00 00 00 00 02 F6 A5
			15 00 00 00 00 00 02 F7 AC
			15 00 00 00 00 00 02 F8 B4
			15 00 00 00 00 00 02 F9 BC
			15 00 00 00 00 00 02 FA C5
			15 00 00 00 00 00 02 FB CF
			15 00 00 00 00 00 02 FC D9
			15 00 00 00 00 00 02 FD E0
			15 00 00 00 00 00 02 FE 00
			15 00 00 00 00 00 02 FF 0E
			//change page 3
			15 00 00 00 00 00 02 83 CC
			15 01 00 00 00 00 02 84 33
			//----B Gamma Register---
			//32
			15 00 00 00 00 00 02 C0 00
			15 00 00 00 00 00 02 C1 01
			15 00 00 00 00 00 02 C2 07
			15 00 00 00 00 00 02 C3 0E
			15 00 00 00 00 00 02 C4 16
			15 00 00 00 00 00 02 C5 23
			15 00 00 00 00 00 02 C6 28
			15 00 00 00 00 00 02 C7 30
			15 00 00 00 00 00 02 C8 36
			15 00 00 00 00 00 02 C9 8A
			15 00 00 00 00 00 02 CA 97
			15 00 00 00 00 00 02 CB B6
			15 00 00 00 00 00 02 CC C7
			15 00 00 00 00 00 02 CD D2
			15 00 00 00 00 00 02 CE D5
			15 00 00 00 00 00 02 CF D7
			15 00 00 00 00 00 02 D0 DC
			15 00 00 00 00 00 02 D1 EC
			15 00 00 00 00 00 02 D2 FB
			15 00 00 00 00 00 02 D3 14
			15 00 00 00 00 00 02 D4 15
			15 00 00 00 00 00 02 D5 8D
			15 00 00 00 00 00 02 D6 93
			15 00 00 00 00 00 02 D7 98
			15 00 00 00 00 00 02 D8 9E
			15 00 00 00 00 00 02 D9 A4
			15 00 00 00 00 00 02 DA AA
			15 00 00 00 00 00 02 DB B1
			15 00 00 00 00 00 02 DC B8
			15 00 00 00 00 00 02 DD BC
			15 00 00 00 00 00 02 DE 00
			15 01 00 00 00 00 02 DF 0C
			//32
			15 00 00 00 00 00 02 E0 00
			15 00 00 00 00 00 02 E1 01
			15 00 00 00 00 00 02 E2 07
			15 00 00 00 00 00 02 E3 0E
			15 00 00 00 00 00 02 E4 16
			15 00 00 00 00 00 02 E5 23
			15 00 00 00 00 00 02 E6 28
			15 00 00 00 00 00 02 E7 30
			15 00 00 00 00 00 02 E8 36
			15 00 00 00 00 00 02 E9 8A
			15 00 00 00 00 00 02 EA 97
			15 00 00 00 00 00 02 EB B6
			15 00 00 00 00 00 02 EC C7
			15 00 00 00 00 00 02 ED D2
			15 00 00 00 00 00 02 EE D5
			15 00 00 00 00 00 02 EF D7
			15 00 00 00 00 00 02 F0 DC
			15 00 00 00 00 00 02 F1 EC
			15 00 00 00 00 00 02 F2 FB
			15 00 00 00 00 00 02 F3 14
			15 00 00 00 00 00 02 F4 15
			15 00 00 00 00 00 02 F5 8D
			15 00 00 00 00 00 02 F6 93
			15 00 00 00 00 00 02 F7 98
			15 00 00 00 00 00 02 F8 9E
			15 00 00 00 00 00 02 F9 A4
			15 00 00 00 00 00 02 FA AA
			15 00 00 00 00 00 02 FB B1
			15 00 00 00 00 00 02 FC B8
			15 00 00 00 00 00 02 FD BC
			15 00 00 00 00 00 02 FE 00
			15 01 00 00 00 00 02 FF 0C
			];
		lge,comfort-view-cmds-step2 = [
			//----R Gamma Register----
			//34
			15 00 00 00 00 00 02 83 AA
			15 00 00 00 00 00 02 84 11
			15 00 00 00 00 00 02 C0 00
			15 00 00 00 00 00 02 C1 0D
			15 00 00 00 00 00 02 C2 12
			15 00 00 00 00 00 02 C3 1A
			15 00 00 00 00 00 02 C4 21
			15 00 00 00 00 00 02 C5 29
			15 00 00 00 00 00 02 C6 32
			15 00 00 00 00 00 02 C7 3A
			15 00 00 00 00 00 02 C8 44
			15 00 00 00 00 00 02 C9 9A
			15 00 00 00 00 00 02 CA A2
			15 00 00 00 00 00 02 CB C0
			15 00 00 00 00 00 02 CC CF
			15 00 00 00 00 00 02 CD DB
			15 00 00 00 00 00 02 CE DE
			15 00 00 00 00 00 02 CF E0
			15 00 00 00 00 00 02 D0 E8
			15 00 00 00 00 00 02 D1 FE
			15 00 00 00 00 00 02 D2 13
			15 00 00 00 00 00 02 D3 37
			15 00 00 00 00 00 02 D4 3F
			15 00 00 00 00 00 02 D5 AA
			15 00 00 00 00 00 02 D6 B1
			15 00 00 00 00 00 02 D7 BA
			15 00 00 00 00 00 02 D8 C3
			15 00 00 00 00 00 02 D9 CD
			15 00 00 00 00 00 02 DA D9
			15 00 00 00 00 00 02 DB E6
			15 00 00 00 00 00 02 DC F8
			15 00 00 00 00 00 02 DD FF
			15 00 00 00 00 00 02 DE 00
			15 01 00 00 00 00 02 DF 0E
			//34
			15 00 00 00 00 00 02 E0 00
			15 00 00 00 00 00 02 E1 0D
			15 00 00 00 00 00 02 E2 12
			15 00 00 00 00 00 02 E3 1A
			15 00 00 00 00 00 02 E4 21
			15 00 00 00 00 00 02 E5 29
			15 00 00 00 00 00 02 E6 32
			15 00 00 00 00 00 02 E7 3A
			15 00 00 00 00 00 02 E8 44
			15 00 00 00 00 00 02 E9 9A
			15 00 00 00 00 00 02 EA A2
			15 00 00 00 00 00 02 EB C0
			15 00 00 00 00 00 02 EC CF
			15 00 00 00 00 00 02 ED DB
			15 00 00 00 00 00 02 EE DE
			15 00 00 00 00 00 02 EF E0
			15 00 00 00 00 00 02 F0 E8
			15 00 00 00 00 00 02 F1 FE
			15 00 00 00 00 00 02 F2 13
			15 00 00 00 00 00 02 F3 37
			15 00 00 00 00 00 02 F4 3F
			15 00 00 00 00 00 02 F5 AA
			15 00 00 00 00 00 02 F6 B1
			15 00 00 00 00 00 02 F7 BA
			15 00 00 00 00 00 02 F8 C3
			15 00 00 00 00 00 02 F9 CD
			15 00 00 00 00 00 02 FA D9
			15 00 00 00 00 00 02 FB E6
			15 00 00 00 00 00 02 FC F8
			15 00 00 00 00 00 02 FD FF
			15 00 00 00 00 00 02 FE 00
			15 00 00 00 00 00 02 FF 0E
			//----G Gamma Register---
			15 00 00 00 00 00 02 83 BB
			15 01 00 00 00 00 02 84 22
			//32
			15 00 00 00 00 00 02 C0 00
			15 00 00 00 00 00 02 C1 05
			15 00 00 00 00 00 02 C2 0C
			15 00 00 00 00 00 02 C3 14
			15 00 00 00 00 00 02 C4 1C
			15 00 00 00 00 00 02 C5 25
			15 00 00 00 00 00 02 C6 2E
			15 00 00 00 00 00 02 C7 37
			15 00 00 00 00 00 02 C8 3F
			15 00 00 00 00 00 02 C9 92
			15 00 00 00 00 00 02 CA 9B
			15 00 00 00 00 00 02 CB B9
			15 00 00 00 00 00 02 CC C9
			15 00 00 00 00 00 02 CD D4
			15 00 00 00 00 00 02 CE D6
			15 00 00 00 00 00 02 CF D8
			15 00 00 00 00 00 02 D0 DE
			15 00 00 00 00 00 02 D1 EE
			15 00 00 00 00 00 02 D2 FF
			15 00 00 00 00 00 02 D3 19
			15 00 00 00 00 00 02 D4 1D
			15 00 00 00 00 00 02 D5 93
			15 00 00 00 00 00 02 D6 99
			15 00 00 00 00 00 02 D7 9F
			15 00 00 00 00 00 02 D8 A5
			15 00 00 00 00 00 02 D9 AC
			15 00 00 00 00 00 02 DA B4
			15 00 00 00 00 00 02 DB BC
			15 00 00 00 00 00 02 DC C4
			15 00 00 00 00 00 02 DD C9
			15 00 00 00 00 00 02 DE 00
			15 01 00 00 00 00 02 DF 0C
			//34
			15 00 00 00 00 00 02 E0 00
			15 00 00 00 00 00 02 E1 05
			15 00 00 00 00 00 02 E2 0C
			15 00 00 00 00 00 02 E3 14
			15 00 00 00 00 00 02 E4 1C
			15 00 00 00 00 00 02 E5 25
			15 00 00 00 00 00 02 E6 2E
			15 00 00 00 00 00 02 E7 37
			15 00 00 00 00 00 02 E8 3F
			15 00 00 00 00 00 02 E9 92
			15 00 00 00 00 00 02 EA 9B
			15 00 00 00 00 00 02 EB B9
			15 00 00 00 00 00 02 EC C9
			15 00 00 00 00 00 02 ED D4
			15 00 00 00 00 00 02 EE D6
			15 00 00 00 00 00 02 EF D8
			15 00 00 00 00 00 02 F0 DE
			15 00 00 00 00 00 02 F1 EE
			15 00 00 00 00 00 02 F2 FF
			15 00 00 00 00 00 02 F3 19
			15 00 00 00 00 00 02 F4 1D
			15 00 00 00 00 00 02 F5 93
			15 00 00 00 00 00 02 F6 99
			15 00 00 00 00 00 02 F7 9F
			15 00 00 00 00 00 02 F8 A5
			15 00 00 00 00 00 02 F9 AC
			15 00 00 00 00 00 02 FA B4
			15 00 00 00 00 00 02 FB BC
			15 00 00 00 00 00 02 FC C4
			15 00 00 00 00 00 02 FD C9
			15 00 00 00 00 00 02 FE 00
			15 00 00 00 00 00 02 FF 0C
			//----B Gamma Register---
			15 00 00 00 00 00 02 83 CC
			15 01 00 00 00 00 02 84 33
			//32
			15 00 00 00 00 00 02 C0 00
			15 00 00 00 00 00 02 C1 03
			15 00 00 00 00 00 02 C2 0B
			15 00 00 00 00 00 02 C3 0D
			15 00 00 00 00 00 02 C4 16
			15 00 00 00 00 00 02 C5 1F
			15 00 00 00 00 00 02 C6 26
			15 00 00 00 00 00 02 C7 30
			15 00 00 00 00 00 02 C8 32
			15 00 00 00 00 00 02 C9 83
			15 00 00 00 00 00 02 CA 90
			15 00 00 00 00 00 02 CB B1
			15 00 00 00 00 00 02 CC C1
			15 00 00 00 00 00 02 CD CC
			15 00 00 00 00 00 02 CE CC
			15 00 00 00 00 00 02 CF CE
			15 00 00 00 00 00 02 D0 D1
			15 00 00 00 00 00 02 D1 DB
			15 00 00 00 00 00 02 D2 E6
			15 00 00 00 00 00 02 D3 F8
			15 00 00 00 00 00 02 D4 F5
			15 00 00 00 00 00 02 D5 7A
			15 00 00 00 00 00 02 D6 7F
			15 00 00 00 00 00 02 D7 83
			15 00 00 00 00 00 02 D8 88
			15 00 00 00 00 00 02 D9 8D
			15 00 00 00 00 00 02 DA 92
			15 00 00 00 00 00 02 DB 97
			15 00 00 00 00 00 02 DC 9D
			15 00 00 00 00 00 02 DD 9F
			15 00 00 00 00 00 02 DE 00
			15 01 00 00 00 00 02 DF 00
			//32
			15 00 00 00 00 00 02 E0 00
			15 00 00 00 00 00 02 E1 03
			15 00 00 00 00 00 02 E2 0B
			15 00 00 00 00 00 02 E3 0D
			15 00 00 00 00 00 02 E4 16
			15 00 00 00 00 00 02 E5 1F
			15 00 00 00 00 00 02 E6 26
			15 00 00 00 00 00 02 E7 30
			15 00 00 00 00 00 02 E8 32
			15 00 00 00 00 00 02 E9 83
			15 00 00 00 00 00 02 EA 90
			15 00 00 00 00 00 02 EB B1
			15 00 00 00 00 00 02 EC C1
			15 00 00 00 00 00 02 ED CC
			15 00 00 00 00 00 02 EE CC
			15 00 00 00 00 00 02 EF CE
			15 00 00 00 00 00 02 F0 D1
			15 00 00 00 00 00 02 F1 DB
			15 00 00 00 00 00 02 F2 E6
			15 00 00 00 00 00 02 F3 F8
			15 00 00 00 00 00 02 F4 F5
			15 00 00 00 00 00 02 F5 7A
			15 00 00 00 00 00 02 F6 7F
			15 00 00 00 00 00 02 F7 83
			15 00 00 00 00 00 02 F8 88
			15 00 00 00 00 00 02 F9 8D
			15 00 00 00 00 00 02 FA 92
			15 00 00 00 00 00 02 FB 97
			15 00 00 00 00 00 02 FC 9D
			15 00 00 00 00 00 02 FD 9F
			15 00 00 00 00 00 02 FE 00
			15 01 00 00 00 00 02 FF 00
			];
		lge,comfort-view-cmds-step3 = [
			//----R Gamma Register----
			//34
			15 00 00 00 00 00 02 83 AA
			15 00 00 00 00 00 02 84 11
			15 00 00 00 00 00 02 C0 00
			15 00 00 00 00 00 02 C1 0D
			15 00 00 00 00 00 02 C2 13
			15 00 00 00 00 00 02 C3 19
			15 00 00 00 00 00 02 C4 22
			15 00 00 00 00 00 02 C5 2B
			15 00 00 00 00 00 02 C6 32
			15 00 00 00 00 00 02 C7 3B
			15 00 00 00 00 00 02 C8 44
			15 00 00 00 00 00 02 C9 9C
			15 00 00 00 00 00 02 CA A3
			15 00 00 00 00 00 02 CB C0
			15 00 00 00 00 00 02 CC D0
			15 00 00 00 00 00 02 CD DB
			15 00 00 00 00 00 02 CE DE
			15 00 00 00 00 00 02 CF E0
			15 00 00 00 00 00 02 D0 E8
			15 00 00 00 00 00 02 D1 FD
			15 00 00 00 00 00 02 D2 13
			15 00 00 00 00 00 02 D3 35
			15 00 00 00 00 00 02 D4 40
			15 00 00 00 00 00 02 D5 AA
			15 00 00 00 00 00 02 D6 B3
			15 00 00 00 00 00 02 D7 BA
			15 00 00 00 00 00 02 D8 C3
			15 00 00 00 00 00 02 D9 CF
			15 00 00 00 00 00 02 DA D9
			15 00 00 00 00 00 02 DB E8
			15 00 00 00 00 00 02 DC F6
			15 00 00 00 00 00 02 DD FF
			15 00 00 00 00 00 02 DE 00
			15 01 00 00 00 00 02 DF 0E
			//34
			15 00 00 00 00 00 02 E0 00
			15 00 00 00 00 00 02 E1 0D
			15 00 00 00 00 00 02 E2 13
			15 00 00 00 00 00 02 E3 19
			15 00 00 00 00 00 02 E4 22
			15 00 00 00 00 00 02 E5 2B
			15 00 00 00 00 00 02 E6 32
			15 00 00 00 00 00 02 E7 3B
			15 00 00 00 00 00 02 E8 44
			15 00 00 00 00 00 02 E9 9C
			15 00 00 00 00 00 02 EA A3
			15 00 00 00 00 00 02 EB C0
			15 00 00 00 00 00 02 EC D0
			15 00 00 00 00 00 02 ED DB
			15 00 00 00 00 00 02 EE DE
			15 00 00 00 00 00 02 EF E0
			15 00 00 00 00 00 02 F0 E8
			15 00 00 00 00 00 02 F1 FD
			15 00 00 00 00 00 02 F2 13
			15 00 00 00 00 00 02 F3 35
			15 00 00 00 00 00 02 F4 40
			15 00 00 00 00 00 02 F5 AA
			15 00 00 00 00 00 02 F6 B3
			15 00 00 00 00 00 02 F7 BA
			15 00 00 00 00 00 02 F8 C3
			15 00 00 00 00 00 02 F9 CF
			15 00 00 00 00 00 02 FA D9
			15 00 00 00 00 00 02 FB E8
			15 00 00 00 00 00 02 FC F6
			15 00 00 00 00 00 02 FD FF
			15 00 00 00 00 00 02 FE 00
			15 00 00 00 00 00 02 FF 0E
			//----G Gamma Register---
			15 00 00 00 00 00 02 83 BB
			15 01 00 00 00 00 02 84 22
			//32
			15 00 00 00 00 00 02 C0 00
			15 00 00 00 00 00 02 C1 05
			15 00 00 00 00 00 02 C2 0D
			15 00 00 00 00 00 02 C3 14
			15 00 00 00 00 00 02 C4 1C
			15 00 00 00 00 00 02 C5 25
			15 00 00 00 00 00 02 C6 2E
			15 00 00 00 00 00 02 C7 36
			15 00 00 00 00 00 02 C8 3F
			15 00 00 00 00 00 02 C9 92
			15 00 00 00 00 00 02 CA 9A
			15 00 00 00 00 00 02 CB B7
			15 00 00 00 00 00 02 CC C7
			15 00 00 00 00 00 02 CD D2
			15 00 00 00 00 00 02 CE D3
			15 00 00 00 00 00 02 CF D5
			15 00 00 00 00 00 02 D0 D9
			15 00 00 00 00 00 02 D1 E8
			15 00 00 00 00 00 02 D2 F7
			15 00 00 00 00 00 02 D3 10
			15 00 00 00 00 00 02 D4 11
			15 00 00 00 00 00 02 D5 8C
			15 00 00 00 00 00 02 D6 91
			15 00 00 00 00 00 02 D7 97
			15 00 00 00 00 00 02 D8 9D
			15 00 00 00 00 00 02 D9 A3
			15 00 00 00 00 00 02 DA AA
			15 00 00 00 00 00 02 DB B1
			15 00 00 00 00 00 02 DC B9
			15 00 00 00 00 00 02 DD BD
			15 00 00 00 00 00 02 DE 00
			15 01 00 00 00 00 02 DF 0C
			//34
			15 00 00 00 00 00 02 E0 00
			15 00 00 00 00 00 02 E1 05
			15 00 00 00 00 00 02 E2 0D
			15 00 00 00 00 00 02 E3 14
			15 00 00 00 00 00 02 E4 1C
			15 00 00 00 00 00 02 E5 25
			15 00 00 00 00 00 02 E6 2E
			15 00 00 00 00 00 02 E7 36
			15 00 00 00 00 00 02 E8 3F
			15 00 00 00 00 00 02 E9 92
			15 00 00 00 00 00 02 EA 9A
			15 00 00 00 00 00 02 EB B7
			15 00 00 00 00 00 02 EC C7
			15 00 00 00 00 00 02 ED D2
			15 00 00 00 00 00 02 EE D3
			15 00 00 00 00 00 02 EF D5
			15 00 00 00 00 00 02 F0 D9
			15 00 00 00 00 00 02 F1 E8
			15 00 00 00 00 00 02 F2 F7
			15 00 00 00 00 00 02 F3 10
			15 00 00 00 00 00 02 F4 11
			15 00 00 00 00 00 02 F5 8C
			15 00 00 00 00 00 02 F6 91
			15 00 00 00 00 00 02 F7 97
			15 00 00 00 00 00 02 F8 9D
			15 00 00 00 00 00 02 F9 A3
			15 00 00 00 00 00 02 FA AA
			15 00 00 00 00 00 02 FB B1
			15 00 00 00 00 00 02 FC B9
			15 00 00 00 00 00 02 FD BD
			15 00 00 00 00 00 02 FE 00
			15 00 00 00 00 00 02 FF 0C
			//----B Gamma Register---
			15 00 00 00 00 00 02 83 CC
			15 01 00 00 00 00 02 84 33
			//32
			15 00 00 00 00 00 02 C0 00
			15 00 00 00 00 00 02 C1 02
			15 00 00 00 00 00 02 C2 06
			15 00 00 00 00 00 02 C3 12
			15 00 00 00 00 00 02 C4 15
			15 00 00 00 00 00 02 C5 1C
			15 00 00 00 00 00 02 C6 27
			15 00 00 00 00 00 02 C7 2D
			15 00 00 00 00 00 02 C8 34
			15 00 00 00 00 00 02 C9 80
			15 00 00 00 00 00 02 CA 8C
			15 00 00 00 00 00 02 CB AC
			15 00 00 00 00 00 02 CC BD
			15 00 00 00 00 00 02 CD C6
			15 00 00 00 00 00 02 CE C5
			15 00 00 00 00 00 02 CF C7
			15 00 00 00 00 00 02 D0 C7
			15 00 00 00 00 00 02 D1 CD
			15 00 00 00 00 00 02 D2 D6
			15 00 00 00 00 00 02 D3 E4
			15 00 00 00 00 00 02 D4 DE
			15 00 00 00 00 00 02 D5 6D
			15 00 00 00 00 00 02 D6 71
			15 00 00 00 00 00 02 D7 75
			15 00 00 00 00 00 02 D8 79
			15 00 00 00 00 00 02 D9 7D
			15 00 00 00 00 00 02 DA 81
			15 00 00 00 00 00 02 DB 86
			15 00 00 00 00 00 02 DC 8A
			15 00 00 00 00 00 02 DD 8D
			15 00 00 00 00 00 02 DE 00
			15 01 00 00 00 00 02 DF 00
			//32
			15 00 00 00 00 00 02 E0 00
			15 00 00 00 00 00 02 E1 02
			15 00 00 00 00 00 02 E2 06
			15 00 00 00 00 00 02 E3 12
			15 00 00 00 00 00 02 E4 15
			15 00 00 00 00 00 02 E5 1C
			15 00 00 00 00 00 02 E6 27
			15 00 00 00 00 00 02 E7 2D
			15 00 00 00 00 00 02 E8 34
			15 00 00 00 00 00 02 E9 80
			15 00 00 00 00 00 02 EA 8C
			15 00 00 00 00 00 02 EB AC
			15 00 00 00 00 00 02 EC BD
			15 00 00 00 00 00 02 ED C6
			15 00 00 00 00 00 02 EE C5
			15 00 00 00 00 00 02 EF C7
			15 00 00 00 00 00 02 F0 C7
			15 00 00 00 00 00 02 F1 CD
			15 00 00 00 00 00 02 F2 D6
			15 00 00 00 00 00 02 F3 E4
			15 00 00 00 00 00 02 F4 DE
			15 00 00 00 00 00 02 F5 6D
			15 00 00 00 00 00 02 F6 71
			15 00 00 00 00 00 02 F7 75
			15 00 00 00 00 00 02 F8 79
			15 00 00 00 00 00 02 F9 7D
			15 00 00 00 00 00 02 FA 81
			15 00 00 00 00 00 02 FB 86
			15 00 00 00 00 00 02 FC 8A
			15 00 00 00 00 00 02 FD 8D
			15 00 00 00 00 00 02 FE 00
			15 01 00 00 00 00 02 FF 00
			];
		lge,comfort-view-cmds-step4 = [
			//----R Gamma Register----
			//34
			15 00 00 00 00 00 02 83 AA
			15 00 00 00 00 00 02 84 11
			15 00 00 00 00 00 02 C0 00
			15 00 00 00 00 00 02 C1 01
			15 00 00 00 00 00 02 C2 08
			15 00 00 00 00 00 02 C3 12
			15 00 00 00 00 00 02 C4 1C
			15 00 00 00 00 00 02 C5 26
			15 00 00 00 00 00 02 C6 31
			15 00 00 00 00 00 02 C7 3A
			15 00 00 00 00 00 02 C8 44
			15 00 00 00 00 00 02 C9 9D
			15 00 00 00 00 00 02 CA A3
			15 00 00 00 00 00 02 CB C0
			15 00 00 00 00 00 02 CC CF
			15 00 00 00 00 00 02 CD DB
			15 00 00 00 00 00 02 CE DF
			15 00 00 00 00 00 02 CF E0
			15 00 00 00 00 00 02 D0 E8
			15 00 00 00 00 00 02 D1 FD
			15 00 00 00 00 00 02 D2 14
			15 00 00 00 00 00 02 D3 36
			15 00 00 00 00 00 02 D4 42
			15 00 00 00 00 00 02 D5 AB
			15 00 00 00 00 00 02 D6 B2
			15 00 00 00 00 00 02 D7 B9
			15 00 00 00 00 00 02 D8 C4
			15 00 00 00 00 00 02 D9 CD
			15 00 00 00 00 00 02 DA DB
			15 00 00 00 00 00 02 DB E8
			15 00 00 00 00 00 02 DC F6
			15 00 00 00 00 00 02 DD FF
			15 00 00 00 00 00 02 DE 00
			15 01 00 00 00 00 02 DF 0E
			//34
			15 00 00 00 00 00 02 E0 00
			15 00 00 00 00 00 02 E1 01
			15 00 00 00 00 00 02 E2 08
			15 00 00 00 00 00 02 E3 12
			15 00 00 00 00 00 02 E4 1C
			15 00 00 00 00 00 02 E5 26
			15 00 00 00 00 00 02 E6 31
			15 00 00 00 00 00 02 E7 3A
			15 00 00 00 00 00 02 E8 44
			15 00 00 00 00 00 02 E9 9D
			15 00 00 00 00 00 02 EA A3
			15 00 00 00 00 00 02 EB C0
			15 00 00 00 00 00 02 EC CF
			15 00 00 00 00 00 02 ED DB
			15 00 00 00 00 00 02 EE DF
			15 00 00 00 00 00 02 EF E0
			15 00 00 00 00 00 02 F0 E8
			15 00 00 00 00 00 02 F1 FD
			15 00 00 00 00 00 02 F2 14
			15 00 00 00 00 00 02 F3 36
			15 00 00 00 00 00 02 F4 42
			15 00 00 00 00 00 02 F5 AB
			15 00 00 00 00 00 02 F6 B2
			15 00 00 00 00 00 02 F7 B9
			15 00 00 00 00 00 02 F8 C4
			15 00 00 00 00 00 02 F9 CD
			15 00 00 00 00 00 02 FA DB
			15 00 00 00 00 00 02 FB E8
			15 00 00 00 00 00 02 FC F6
			15 00 00 00 00 00 02 FD FF
			15 00 00 00 00 00 02 FE 00
			15 00 00 00 00 00 02 FF 0E
			//----G Gamma Register---
			15 00 00 00 00 00 02 83 BB
			15 01 00 00 00 00 02 84 22
			//32
			15 00 00 00 00 00 02 C0 00
			15 00 00 00 00 00 02 C1 0C
			15 00 00 00 00 00 02 C2 10
			15 00 00 00 00 00 02 C3 16
			15 00 00 00 00 00 02 C4 1D
			15 00 00 00 00 00 02 C5 25
			15 00 00 00 00 00 02 C6 2D
			15 00 00 00 00 00 02 C7 35
			15 00 00 00 00 00 02 C8 3E
			15 00 00 00 00 00 02 C9 91
			15 00 00 00 00 00 02 CA 97
			15 00 00 00 00 00 02 CB B5
			15 00 00 00 00 00 02 CC C5
			15 00 00 00 00 00 02 CD CF
			15 00 00 00 00 00 02 CE D0
			15 00 00 00 00 00 02 CF D2
			15 00 00 00 00 00 02 D0 D5
			15 00 00 00 00 00 02 D1 E1
			15 00 00 00 00 00 02 D2 EE
			15 00 00 00 00 00 02 D3 04
			15 00 00 00 00 00 02 D4 03
			15 00 00 00 00 00 02 D5 83
			15 00 00 00 00 00 02 D6 88
			15 00 00 00 00 00 02 D7 8E
			15 00 00 00 00 00 02 D8 93
			15 00 00 00 00 00 02 D9 99
			15 00 00 00 00 00 02 DA 9E
			15 00 00 00 00 00 02 DB A5
			15 00 00 00 00 00 02 DC AC
			15 00 00 00 00 00 02 DD AF
			15 00 00 00 00 00 02 DE 00
			15 01 00 00 00 00 02 DF 0C
			//34
			15 00 00 00 00 00 02 E0 00
			15 00 00 00 00 00 02 E1 0C
			15 00 00 00 00 00 02 E2 10
			15 00 00 00 00 00 02 E3 16
			15 00 00 00 00 00 02 E4 1D
			15 00 00 00 00 00 02 E5 25
			15 00 00 00 00 00 02 E6 2D
			15 00 00 00 00 00 02 E7 35
			15 00 00 00 00 00 02 E8 3E
			15 00 00 00 00 00 02 E9 91
			15 00 00 00 00 00 02 EA 97
			15 00 00 00 00 00 02 EB B5
			15 00 00 00 00 00 02 EC C5
			15 00 00 00 00 00 02 ED CF
			15 00 00 00 00 00 02 EE D0
			15 00 00 00 00 00 02 EF D2
			15 00 00 00 00 00 02 F0 D5
			15 00 00 00 00 00 02 F1 E1
			15 00 00 00 00 00 02 F2 EE
			15 00 00 00 00 00 02 F3 04
			15 00 00 00 00 00 02 F4 03
			15 00 00 00 00 00 02 F5 83
			15 00 00 00 00 00 02 F6 88
			15 00 00 00 00 00 02 F7 8E
			15 00 00 00 00 00 02 F8 93
			15 00 00 00 00 00 02 F9 99
			15 00 00 00 00 00 02 FA 9E
			15 00 00 00 00 00 02 FB A5
			15 00 00 00 00 00 02 FC AC
			15 00 00 00 00 00 02 FD AF
			15 00 00 00 00 00 02 FE 00
			15 00 00 00 00 00 02 FF 0C
			//----B Gamma Register---
			15 00 00 00 00 00 02 83 CC
			15 01 00 00 00 00 02 84 33
			//32
			15 00 00 00 00 00 02 C0 00
			15 00 00 00 00 00 02 C1 01
			15 00 00 00 00 00 02 C2 06
			15 00 00 00 00 00 02 C3 0D
			15 00 00 00 00 00 02 C4 14
			15 00 00 00 00 00 02 C5 1B
			15 00 00 00 00 00 02 C6 28
			15 00 00 00 00 00 02 C7 2E
			15 00 00 00 00 00 02 C8 33
			15 00 00 00 00 00 02 C9 7B
			15 00 00 00 00 00 02 CA 86
			15 00 00 00 00 00 02 CB A6
			15 00 00 00 00 00 02 CC B6
			15 00 00 00 00 00 02 CD C0
			15 00 00 00 00 00 02 CE BE
			15 00 00 00 00 00 02 CF BF
			15 00 00 00 00 00 02 D0 BC
			15 00 00 00 00 00 02 D1 BF
			15 00 00 00 00 00 02 D2 C4
			15 00 00 00 00 00 02 D3 CE
			15 00 00 00 00 00 02 D4 C5
			15 00 00 00 00 00 02 D5 5F
			15 00 00 00 00 00 02 D6 62
			15 00 00 00 00 00 02 D7 66
			15 00 00 00 00 00 02 D8 69
			15 00 00 00 00 00 02 D9 6D
			15 00 00 00 00 00 02 DA 71
			15 00 00 00 00 00 02 DB 74
			15 00 00 00 00 00 02 DC 78
			15 00 00 00 00 00 02 DD 7A
			15 00 00 00 00 00 02 DE 00
			15 01 00 00 00 00 02 DF 00
			//32
			15 00 00 00 00 00 02 E0 00
			15 00 00 00 00 00 02 E1 01
			15 00 00 00 00 00 02 E2 06
			15 00 00 00 00 00 02 E3 0D
			15 00 00 00 00 00 02 E4 14
			15 00 00 00 00 00 02 E5 1B
			15 00 00 00 00 00 02 E6 28
			15 00 00 00 00 00 02 E7 2E
			15 00 00 00 00 00 02 E8 33
			15 00 00 00 00 00 02 E9 7B
			15 00 00 00 00 00 02 EA 86
			15 00 00 00 00 00 02 EB A6
			15 00 00 00 00 00 02 EC B6
			15 00 00 00 00 00 02 ED C0
			15 00 00 00 00 00 02 EE BE
			15 00 00 00 00 00 02 EF BF
			15 00 00 00 00 00 02 F0 BC
			15 00 00 00 00 00 02 F1 BF
			15 00 00 00 00 00 02 F2 C4
			15 00 00 00 00 00 02 F3 CE
			15 00 00 00 00 00 02 F4 C5
			15 00 00 00 00 00 02 F5 5F
			15 00 00 00 00 00 02 F6 62
			15 00 00 00 00 00 02 F7 66
			15 00 00 00 00 00 02 F8 69
			15 00 00 00 00 00 02 F9 6D
			15 00 00 00 00 00 02 FA 71
			15 00 00 00 00 00 02 FB 74
			15 00 00 00 00 00 02 FC 78
			15 00 00 00 00 00 02 FD 7A
			15 00 00 00 00 00 02 FE 00
			15 01 00 00 00 00 02 FF 00
			];
		lge,comfort-view-cmds-step5 = [
			//----R Gamma Register----
			//34
			15 00 00 00 00 00 02 83 AA
			15 00 00 00 00 00 02 84 11
			15 00 00 00 00 00 02 C0 00
			15 00 00 00 00 00 02 C1 0D
			15 00 00 00 00 00 02 C2 13
			15 00 00 00 00 00 02 C3 1A
			15 00 00 00 00 00 02 C4 20
			15 00 00 00 00 00 02 C5 2B
			15 00 00 00 00 00 02 C6 32
			15 00 00 00 00 00 02 C7 3A
			15 00 00 00 00 00 02 C8 44
			15 00 00 00 00 00 02 C9 9D
			15 00 00 00 00 00 02 CA A3
			15 00 00 00 00 00 02 CB C0
			15 00 00 00 00 00 02 CC CF
			15 00 00 00 00 00 02 CD DB
			15 00 00 00 00 00 02 CE DE
			15 00 00 00 00 00 02 CF E0
			15 00 00 00 00 00 02 D0 E8
			15 00 00 00 00 00 02 D1 FD
			15 00 00 00 00 00 02 D2 12
			15 00 00 00 00 00 02 D3 35
			15 00 00 00 00 00 02 D4 41
			15 00 00 00 00 00 02 D5 A9
			15 00 00 00 00 00 02 D6 B1
			15 00 00 00 00 00 02 D7 BB
			15 00 00 00 00 00 02 D8 C4
			15 00 00 00 00 00 02 D9 CC
			15 00 00 00 00 00 02 DA DB
			15 00 00 00 00 00 02 DB E5
			15 00 00 00 00 00 02 DC F5
			15 00 00 00 00 00 02 DD FF
			15 00 00 00 00 00 02 DE 00
			15 01 00 00 00 00 02 DF 0E
			//34
			15 00 00 00 00 00 02 E0 00
			15 00 00 00 00 00 02 E1 0D
			15 00 00 00 00 00 02 E2 13
			15 00 00 00 00 00 02 E3 1A
			15 00 00 00 00 00 02 E4 20
			15 00 00 00 00 00 02 E5 2B
			15 00 00 00 00 00 02 E6 32
			15 00 00 00 00 00 02 E7 3A
			15 00 00 00 00 00 02 E8 44
			15 00 00 00 00 00 02 E9 9D
			15 00 00 00 00 00 02 EA A3
			15 00 00 00 00 00 02 EB C0
			15 00 00 00 00 00 02 EC CF
			15 00 00 00 00 00 02 ED DB
			15 00 00 00 00 00 02 EE DE
			15 00 00 00 00 00 02 EF E0
			15 00 00 00 00 00 02 F0 E8
			15 00 00 00 00 00 02 F1 FD
			15 00 00 00 00 00 02 F2 12
			15 00 00 00 00 00 02 F3 35
			15 00 00 00 00 00 02 F4 41
			15 00 00 00 00 00 02 F5 A9
			15 00 00 00 00 00 02 F6 B1
			15 00 00 00 00 00 02 F7 BB
			15 00 00 00 00 00 02 F8 C4
			15 00 00 00 00 00 02 F9 CC
			15 00 00 00 00 00 02 FA DB
			15 00 00 00 00 00 02 FB E5
			15 00 00 00 00 00 02 FC F5
			15 00 00 00 00 00 02 FD FF
			15 00 00 00 00 00 02 FE 00
			15 00 00 00 00 00 02 FF 0E
			//----G Gamma Register---
			15 00 00 00 00 00 02 83 BB
			15 01 00 00 00 00 02 84 22
			//32
			15 00 00 00 00 00 02 C0 00
			15 00 00 00 00 00 02 C1 05
			15 00 00 00 00 00 02 C2 0D
			15 00 00 00 00 00 02 C3 13
			15 00 00 00 00 00 02 C4 1B
			15 00 00 00 00 00 02 C5 24
			15 00 00 00 00 00 02 C6 2C
			15 00 00 00 00 00 02 C7 34
			15 00 00 00 00 00 02 C8 3D
			15 00 00 00 00 00 02 C9 8F
			15 00 00 00 00 00 02 CA 95
			15 00 00 00 00 00 02 CB B3
			15 00 00 00 00 00 02 CC C3
			15 00 00 00 00 00 02 CD CC
			15 00 00 00 00 00 02 CE CC
			15 00 00 00 00 00 02 CF CE
			15 00 00 00 00 00 02 D0 D0
			15 00 00 00 00 00 02 D1 DA
			15 00 00 00 00 00 02 D2 E6
			15 00 00 00 00 00 02 D3 F9
			15 00 00 00 00 00 02 D4 F6
			15 00 00 00 00 00 02 D5 7C
			15 00 00 00 00 00 02 D6 80
			15 00 00 00 00 00 02 D7 85
			15 00 00 00 00 00 02 D8 8A
			15 00 00 00 00 00 02 D9 8F
			15 00 00 00 00 00 02 DA 94
			15 00 00 00 00 00 02 DB 9A
			15 00 00 00 00 00 02 DC A0
			15 00 00 00 00 00 02 DD A3
			15 00 00 00 00 00 02 DE 00
			15 01 00 00 00 00 02 DF 00
			//34
			15 00 00 00 00 00 02 E0 00
			15 00 00 00 00 00 02 E1 05
			15 00 00 00 00 00 02 E2 0D
			15 00 00 00 00 00 02 E3 13
			15 00 00 00 00 00 02 E4 1B
			15 00 00 00 00 00 02 E5 24
			15 00 00 00 00 00 02 E6 2C
			15 00 00 00 00 00 02 E7 34
			15 00 00 00 00 00 02 E8 3D
			15 00 00 00 00 00 02 E9 8F
			15 00 00 00 00 00 02 EA 95
			15 00 00 00 00 00 02 EB B3
			15 00 00 00 00 00 02 EC C3
			15 00 00 00 00 00 02 ED CC
			15 00 00 00 00 00 02 EE CC
			15 00 00 00 00 00 02 EF CE
			15 00 00 00 00 00 02 F0 D0
			15 00 00 00 00 00 02 F1 DA
			15 00 00 00 00 00 02 F2 E6
			15 00 00 00 00 00 02 F3 F9
			15 00 00 00 00 00 02 F4 F6
			15 00 00 00 00 00 02 F5 7C
			15 00 00 00 00 00 02 F6 80
			15 00 00 00 00 00 02 F7 85
			15 00 00 00 00 00 02 F8 8A
			15 00 00 00 00 00 02 F9 8F
			15 00 00 00 00 00 02 FA 94
			15 00 00 00 00 00 02 FB 9A
			15 00 00 00 00 00 02 FC A0
			15 00 00 00 00 00 02 FD A3
			15 00 00 00 00 00 02 FE 00
			15 00 00 00 00 00 02 FF 00
			//----B Gamma Register---
			15 00 00 00 00 00 02 83 CC
			15 01 00 00 00 00 02 84 33
			//32
			15 00 00 00 00 00 02 C0 00
			15 00 00 00 00 00 02 C1 02
			15 00 00 00 00 00 02 C2 03
			15 00 00 00 00 00 02 C3 0D
			15 00 00 00 00 00 02 C4 19
			15 00 00 00 00 00 02 C5 1B
			15 00 00 00 00 00 02 C6 25
			15 00 00 00 00 00 02 C7 2B
			15 00 00 00 00 00 02 C8 31
			15 00 00 00 00 00 02 C9 74
			15 00 00 00 00 00 02 CA 80
			15 00 00 00 00 00 02 CB A1
			15 00 00 00 00 00 02 CC B1
			15 00 00 00 00 00 02 CD B9
			15 00 00 00 00 00 02 CE B5
			15 00 00 00 00 00 02 CF B7
			15 00 00 00 00 00 02 D0 B2
			15 00 00 00 00 00 02 D1 B1
			15 00 00 00 00 00 02 D2 B4
			15 00 00 00 00 00 02 D3 BA
			15 00 00 00 00 00 02 D4 AF
			15 00 00 00 00 00 02 D5 53
			15 00 00 00 00 00 02 D6 55
			15 00 00 00 00 00 02 D7 58
			15 00 00 00 00 00 02 D8 5C
			15 00 00 00 00 00 02 D9 5F
			15 00 00 00 00 00 02 DA 62
			15 00 00 00 00 00 02 DB 65
			15 00 00 00 00 00 02 DC 69
			15 00 00 00 00 00 02 DD 6A
			15 00 00 00 00 00 02 DE 00
			15 01 00 00 00 00 02 DF 00
			//32
			15 00 00 00 00 00 02 E0 00
			15 00 00 00 00 00 02 E1 02
			15 00 00 00 00 00 02 E2 03
			15 00 00 00 00 00 02 E3 0D
			15 00 00 00 00 00 02 E4 19
			15 00 00 00 00 00 02 E5 1B
			15 00 00 00 00 00 02 E6 25
			15 00 00 00 00 00 02 E7 2B
			15 00 00 00 00 00 02 E8 31
			15 00 00 00 00 00 02 E9 74
			15 00 00 00 00 00 02 EA 80
			15 00 00 00 00 00 02 EB A1
			15 00 00 00 00 00 02 EC B1
			15 00 00 00 00 00 02 ED B9
			15 00 00 00 00 00 02 EE B5
			15 00 00 00 00 00 02 EF B7
			15 00 00 00 00 00 02 F0 B2
			15 00 00 00 00 00 02 F1 B1
			15 00 00 00 00 00 02 F2 B4
			15 00 00 00 00 00 02 F3 BA
			15 00 00 00 00 00 02 F4 AF
			15 00 00 00 00 00 02 F5 53
			15 00 00 00 00 00 02 F6 55
			15 00 00 00 00 00 02 F7 58
			15 00 00 00 00 00 02 F8 5C
			15 00 00 00 00 00 02 F9 5F
			15 00 00 00 00 00 02 FA 62
			15 00 00 00 00 00 02 FB 65
			15 00 00 00 00 00 02 FC 69
			15 00 00 00 00 00 02 FD 6A
			15 00 00 00 00 00 02 FE 00
			15 01 00 00 00 00 02 FF 00
			];
		lge,comfort-view-cmds-step6 = [
			//----R Gamma Register----
			//34
			15 00 00 00 00 00 02 83 AA
			15 00 00 00 00 00 02 84 11
			15 00 00 00 00 00 02 C0 00
			15 00 00 00 00 00 02 C1 01
			15 00 00 00 00 00 02 C2 08
			15 00 00 00 00 00 02 C3 12
			15 00 00 00 00 00 02 C4 1C
			15 00 00 00 00 00 02 C5 26
			15 00 00 00 00 00 02 C6 32
			15 00 00 00 00 00 02 C7 3A
			15 00 00 00 00 00 02 C8 44
			15 00 00 00 00 00 02 C9 9C
			15 00 00 00 00 00 02 CA A4
			15 00 00 00 00 00 02 CB C0
			15 00 00 00 00 00 02 CC CF
			15 00 00 00 00 00 02 CD DA
			15 00 00 00 00 00 02 CE DE
			15 00 00 00 00 00 02 CF E1
			15 00 00 00 00 00 02 D0 E8
			15 00 00 00 00 00 02 D1 FD
			15 00 00 00 00 00 02 D2 13
			15 00 00 00 00 00 02 D3 35
			15 00 00 00 00 00 02 D4 3F
			15 00 00 00 00 00 02 D5 A9
			15 00 00 00 00 00 02 D6 B2
			15 00 00 00 00 00 02 D7 BA
			15 00 00 00 00 00 02 D8 C4
			15 00 00 00 00 00 02 D9 CF
			15 00 00 00 00 00 02 DA DB
			15 00 00 00 00 00 02 DB EA
			15 00 00 00 00 00 02 DC F8
			15 00 00 00 00 00 02 DD FF
			15 00 00 00 00 00 02 DE 00
			15 01 00 00 00 00 02 DF 0E
			//34
			15 00 00 00 00 00 02 E0 00
			15 00 00 00 00 00 02 E1 01
			15 00 00 00 00 00 02 E2 08
			15 00 00 00 00 00 02 E3 12
			15 00 00 00 00 00 02 E4 1C
			15 00 00 00 00 00 02 E5 26
			15 00 00 00 00 00 02 E6 32
			15 00 00 00 00 00 02 E7 3A
			15 00 00 00 00 00 02 E8 44
			15 00 00 00 00 00 02 E9 9C
			15 00 00 00 00 00 02 EA A4
			15 00 00 00 00 00 02 EB C0
			15 00 00 00 00 00 02 EC CF
			15 00 00 00 00 00 02 ED DA
			15 00 00 00 00 00 02 EE DE
			15 00 00 00 00 00 02 EF E1
			15 00 00 00 00 00 02 F0 E8
			15 00 00 00 00 00 02 F1 FD
			15 00 00 00 00 00 02 F2 13
			15 00 00 00 00 00 02 F3 35
			15 00 00 00 00 00 02 F4 3F
			15 00 00 00 00 00 02 F5 A9
			15 00 00 00 00 00 02 F6 B2
			15 00 00 00 00 00 02 F7 BA
			15 00 00 00 00 00 02 F8 C4
			15 00 00 00 00 00 02 F9 CF
			15 00 00 00 00 00 02 FA DB
			15 00 00 00 00 00 02 FB EA
			15 00 00 00 00 00 02 FC F8
			15 00 00 00 00 00 02 FD FF
			15 00 00 00 00 00 02 FE 00
			15 00 00 00 00 00 02 FF 0E
			//----G Gamma Register---
			15 00 00 00 00 00 02 83 BB
			15 01 00 00 00 00 02 84 22
			//32
			15 00 00 00 00 00 02 C0 00
			15 00 00 00 00 00 02 C1 0C
			15 00 00 00 00 00 02 C2 10
			15 00 00 00 00 00 02 C3 15
			15 00 00 00 00 00 02 C4 1C
			15 00 00 00 00 00 02 C5 24
			15 00 00 00 00 00 02 C6 2C
			15 00 00 00 00 00 02 C7 34
			15 00 00 00 00 00 02 C8 3C
			15 00 00 00 00 00 02 C9 8D
			15 00 00 00 00 00 02 CA 93
			15 00 00 00 00 00 02 CB B1
			15 00 00 00 00 00 02 CC C0
			15 00 00 00 00 00 02 CD C9
			15 00 00 00 00 00 02 CE C9
			15 00 00 00 00 00 02 CF CB
			15 00 00 00 00 00 02 D0 CB
			15 00 00 00 00 00 02 D1 D3
			15 00 00 00 00 00 02 D2 DD
			15 00 00 00 00 00 02 D3 EE
			15 00 00 00 00 00 02 D4 EA
			15 00 00 00 00 00 02 D5 74
			15 00 00 00 00 00 02 D6 78
			15 00 00 00 00 00 02 D7 7D
			15 00 00 00 00 00 02 D8 81
			15 00 00 00 00 00 02 D9 86
			15 00 00 00 00 00 02 DA 8B
			15 00 00 00 00 00 02 DB 90
			15 00 00 00 00 00 02 DC 95
			15 00 00 00 00 00 02 DD 98
			15 00 00 00 00 00 02 DE 00
			15 01 00 00 00 00 02 DF 00
			//34
			15 00 00 00 00 00 02 E0 00
			15 00 00 00 00 00 02 E1 0C
			15 00 00 00 00 00 02 E2 10
			15 00 00 00 00 00 02 E3 15
			15 00 00 00 00 00 02 E4 1C
			15 00 00 00 00 00 02 E5 24
			15 00 00 00 00 00 02 E6 2C
			15 00 00 00 00 00 02 E7 34
			15 00 00 00 00 00 02 E8 3C
			15 00 00 00 00 00 02 E9 8D
			15 00 00 00 00 00 02 EA 93
			15 00 00 00 00 00 02 EB B1
			15 00 00 00 00 00 02 EC C0
			15 00 00 00 00 00 02 ED C9
			15 00 00 00 00 00 02 EE C9
			15 00 00 00 00 00 02 EF CB
			15 00 00 00 00 00 02 F0 CB
			15 00 00 00 00 00 02 F1 D3
			15 00 00 00 00 00 02 F2 DD
			15 00 00 00 00 00 02 F3 EE
			15 00 00 00 00 00 02 F4 EA
			15 00 00 00 00 00 02 F5 74
			15 00 00 00 00 00 02 F6 78
			15 00 00 00 00 00 02 F7 7D
			15 00 00 00 00 00 02 F8 81
			15 00 00 00 00 00 02 F9 86
			15 00 00 00 00 00 02 FA 8B
			15 00 00 00 00 00 02 FB 90
			15 00 00 00 00 00 02 FC 95
			15 00 00 00 00 00 02 FD 98
			15 00 00 00 00 00 02 FE 00
			15 00 00 00 00 00 02 FF 00
			//----B Gamma Register---
			15 00 00 00 00 00 02 83 CC
			15 01 00 00 00 00 02 84 33
			//32
			15 00 00 00 00 00 02 C0 00
			15 00 00 00 00 00 02 C1 01
			15 00 00 00 00 00 02 C2 05
			15 00 00 00 00 00 02 C3 0B
			15 00 00 00 00 00 02 C4 12
			15 00 00 00 00 00 02 C5 19
			15 00 00 00 00 00 02 C6 22
			15 00 00 00 00 00 02 C7 29
			15 00 00 00 00 00 02 C8 2E
			15 00 00 00 00 00 02 C9 72
			15 00 00 00 00 00 02 CA 79
			15 00 00 00 00 00 02 CB 99
			15 00 00 00 00 00 02 CC A9
			15 00 00 00 00 00 02 CD B0
			15 00 00 00 00 00 02 CE AB
			15 00 00 00 00 00 02 CF AD
			15 00 00 00 00 00 02 D0 A4
			15 00 00 00 00 00 02 D1 9F
			15 00 00 00 00 00 02 D2 9E
			15 00 00 00 00 00 02 D3 A1
			15 00 00 00 00 00 02 D4 93
			15 00 00 00 00 00 02 D5 43
			15 00 00 00 00 00 02 D6 46
			15 00 00 00 00 00 02 D7 48
			15 00 00 00 00 00 02 D8 4B
			15 00 00 00 00 00 02 D9 4E
			15 00 00 00 00 00 02 DA 50
			15 00 00 00 00 00 02 DB 53
			15 00 00 00 00 00 02 DC 56
			15 00 00 00 00 00 02 DD 57
			15 00 00 00 00 00 02 DE 00
			15 01 00 00 00 00 02 DF 00
			//32
			15 00 00 00 00 00 02 E0 00
			15 00 00 00 00 00 02 E1 01
			15 00 00 00 00 00 02 E2 05
			15 00 00 00 00 00 02 E3 0B
			15 00 00 00 00 00 02 E4 12
			15 00 00 00 00 00 02 E5 19
			15 00 00 00 00 00 02 E6 22
			15 00 00 00 00 00 02 E7 29
			15 00 00 00 00 00 02 E8 2E
			15 00 00 00 00 00 02 E9 72
			15 00 00 00 00 00 02 EA 79
			15 00 00 00 00 00 02 EB 99
			15 00 00 00 00 00 02 EC A9
			15 00 00 00 00 00 02 ED B0
			15 00 00 00 00 00 02 EE AB
			15 00 00 00 00 00 02 EF AD
			15 00 00 00 00 00 02 F0 A4
			15 00 00 00 00 00 02 F1 9F
			15 00 00 00 00 00 02 F2 9E
			15 00 00 00 00 00 02 F3 A1
			15 00 00 00 00 00 02 F4 93
			15 00 00 00 00 00 02 F5 43
			15 00 00 00 00 00 02 F6 46
			15 00 00 00 00 00 02 F7 48
			15 00 00 00 00 00 02 F8 4B
			15 00 00 00 00 00 02 F9 4E
			15 00 00 00 00 00 02 FA 50
			15 00 00 00 00 00 02 FB 53
			15 00 00 00 00 00 02 FC 56
			15 00 00 00 00 00 02 FD 57
			15 00 00 00 00 00 02 FE 00
			15 01 00 00 00 00 02 FF 00
			];
		lge,comfort-view-cmds-step7 = [
			//----R Gamma Register----
			//34
			15 00 00 00 00 00 02 83 AA
			15 00 00 00 00 00 02 84 11
			15 00 00 00 00 00 02 C0 00
			15 00 00 00 00 00 02 C1 01
			15 00 00 00 00 00 02 C2 08
			15 00 00 00 00 00 02 C3 12
			15 00 00 00 00 00 02 C4 1C
			15 00 00 00 00 00 02 C5 28
			15 00 00 00 00 00 02 C6 32
			15 00 00 00 00 00 02 C7 3B
			15 00 00 00 00 00 02 C8 44
			15 00 00 00 00 00 02 C9 9C
			15 00 00 00 00 00 02 CA A4
			15 00 00 00 00 00 02 CB C1
			15 00 00 00 00 00 02 CC CF
			15 00 00 00 00 00 02 CD DB
			15 00 00 00 00 00 02 CE DE
			15 00 00 00 00 00 02 CF E0
			15 00 00 00 00 00 02 D0 E8
			15 00 00 00 00 00 02 D1 FE
			15 00 00 00 00 00 02 D2 15
			15 00 00 00 00 00 02 D3 37
			15 00 00 00 00 00 02 D4 3F
			15 00 00 00 00 00 02 D5 AA
			15 00 00 00 00 00 02 D6 B2
			15 00 00 00 00 00 02 D7 BB
			15 00 00 00 00 00 02 D8 C6
			15 00 00 00 00 00 02 D9 CF
			15 00 00 00 00 00 02 DA DB
			15 00 00 00 00 00 02 DB E6
			15 00 00 00 00 00 02 DC FC
			15 00 00 00 00 00 02 DD FF
			15 00 00 00 00 00 02 DE 00
			15 01 00 00 00 00 02 DF 0E
			//34
			15 00 00 00 00 00 02 E0 00
			15 00 00 00 00 00 02 E1 01
			15 00 00 00 00 00 02 E2 08
			15 00 00 00 00 00 02 E3 12
			15 00 00 00 00 00 02 E4 1C
			15 00 00 00 00 00 02 E5 28
			15 00 00 00 00 00 02 E6 32
			15 00 00 00 00 00 02 E7 3B
			15 00 00 00 00 00 02 E8 44
			15 00 00 00 00 00 02 E9 9C
			15 00 00 00 00 00 02 EA A4
			15 00 00 00 00 00 02 EB C1
			15 00 00 00 00 00 02 EC CF
			15 00 00 00 00 00 02 ED DB
			15 00 00 00 00 00 02 EE DE
			15 00 00 00 00 00 02 EF E0
			15 00 00 00 00 00 02 F0 E8
			15 00 00 00 00 00 02 F1 FE
			15 00 00 00 00 00 02 F2 15
			15 00 00 00 00 00 02 F3 37
			15 00 00 00 00 00 02 F4 3F
			15 00 00 00 00 00 02 F5 AA
			15 00 00 00 00 00 02 F6 B2
			15 00 00 00 00 00 02 F7 BB
			15 00 00 00 00 00 02 F8 C6
			15 00 00 00 00 00 02 F9 CF
			15 00 00 00 00 00 02 FA DB
			15 00 00 00 00 00 02 FB E6
			15 00 00 00 00 00 02 FC FC
			15 00 00 00 00 00 02 FD FF
			15 00 00 00 00 00 02 FE 00
			15 00 00 00 00 00 02 FF 0E
			//----G Gamma Register---
			15 00 00 00 00 00 02 83 BB
			15 01 00 00 00 00 02 84 22
			//32
			15 00 00 00 00 00 02 C0 00
			15 00 00 00 00 00 02 C1 0C
			15 00 00 00 00 00 02 C2 0F
			15 00 00 00 00 00 02 C3 15
			15 00 00 00 00 00 02 C4 1A
			15 00 00 00 00 00 02 C5 23
			15 00 00 00 00 00 02 C6 2B
			15 00 00 00 00 00 02 C7 33
			15 00 00 00 00 00 02 C8 3B
			15 00 00 00 00 00 02 C9 8B
			15 00 00 00 00 00 02 CA 93
			15 00 00 00 00 00 02 CB AF
			15 00 00 00 00 00 02 CC BE
			15 00 00 00 00 00 02 CD C7
			15 00 00 00 00 00 02 CE C5
			15 00 00 00 00 00 02 CF C7
			15 00 00 00 00 00 02 D0 C7
			15 00 00 00 00 00 02 D1 CD
			15 00 00 00 00 00 02 D2 D5
			15 00 00 00 00 00 02 D3 E4
			15 00 00 00 00 00 02 D4 DF
			15 00 00 00 00 00 02 D5 6E
			15 00 00 00 00 00 02 D6 72
			15 00 00 00 00 00 02 D7 76
			15 00 00 00 00 00 02 D8 7A
			15 00 00 00 00 00 02 D9 7E
			15 00 00 00 00 00 02 DA 83
			15 00 00 00 00 00 02 DB 88
			15 00 00 00 00 00 02 DC 8C
			15 00 00 00 00 00 02 DD 8F
			15 00 00 00 00 00 02 DE 00
			15 01 00 00 00 00 02 DF 00
			//34
			15 00 00 00 00 00 02 E0 00
			15 00 00 00 00 00 02 E1 0C
			15 00 00 00 00 00 02 E2 0F
			15 00 00 00 00 00 02 E3 15
			15 00 00 00 00 00 02 E4 1A
			15 00 00 00 00 00 02 E5 23
			15 00 00 00 00 00 02 E6 2B
			15 00 00 00 00 00 02 E7 33
			15 00 00 00 00 00 02 E8 3B
			15 00 00 00 00 00 02 E9 8B
			15 00 00 00 00 00 02 EA 93
			15 00 00 00 00 00 02 EB AF
			15 00 00 00 00 00 02 EC BE
			15 00 00 00 00 00 02 ED C7
			15 00 00 00 00 00 02 EE C5
			15 00 00 00 00 00 02 EF C7
			15 00 00 00 00 00 02 F0 C7
			15 00 00 00 00 00 02 F1 CD
			15 00 00 00 00 00 02 F2 D5
			15 00 00 00 00 00 02 F3 E4
			15 00 00 00 00 00 02 F4 DF
			15 00 00 00 00 00 02 F5 6E
			15 00 00 00 00 00 02 F6 72
			15 00 00 00 00 00 02 F7 76
			15 00 00 00 00 00 02 F8 7A
			15 00 00 00 00 00 02 F9 7E
			15 00 00 00 00 00 02 FA 83
			15 00 00 00 00 00 02 FB 88
			15 00 00 00 00 00 02 FC 8C
			15 00 00 00 00 00 02 FD 8F
			15 00 00 00 00 00 02 FE 00
			15 00 00 00 00 00 02 FF 00
			//----B Gamma Register---
			15 00 00 00 00 00 02 83 CC
			15 01 00 00 00 00 02 84 33
			//32
			15 00 00 00 00 00 02 C0 00
			15 00 00 00 00 00 02 C1 01
			15 00 00 00 00 00 02 C2 05
			15 00 00 00 00 00 02 C3 0B
			15 00 00 00 00 00 02 C4 1D
			15 00 00 00 00 00 02 C5 1E
			15 00 00 00 00 00 02 C6 20
			15 00 00 00 00 00 02 C7 25
			15 00 00 00 00 00 02 C8 2C
			15 00 00 00 00 00 02 C9 6C
			15 00 00 00 00 00 02 CA 73
			15 00 00 00 00 00 02 CB 92
			15 00 00 00 00 00 02 CC A1
			15 00 00 00 00 00 02 CD A8
			15 00 00 00 00 00 02 CE A0
			15 00 00 00 00 00 02 CF A2
			15 00 00 00 00 00 02 D0 97
			15 00 00 00 00 00 02 D1 8F
			15 00 00 00 00 00 02 D2 8B
			15 00 00 00 00 00 02 D3 8A
			15 00 00 00 00 00 02 D4 7B
			15 00 00 00 00 00 02 D5 36
			15 00 00 00 00 00 02 D6 38
			15 00 00 00 00 00 02 D7 3A
			15 00 00 00 00 00 02 D8 3C
			15 00 00 00 00 00 02 D9 3F
			15 00 00 00 00 00 02 DA 42
			15 00 00 00 00 00 02 DB 44
			15 00 00 00 00 00 02 DC 46
			15 00 00 00 00 00 02 DD 47
			15 00 00 00 00 00 02 DE 00
			15 01 00 00 00 00 02 DF 00
			//32
			15 00 00 00 00 00 02 E0 00
			15 00 00 00 00 00 02 E1 01
			15 00 00 00 00 00 02 E2 05
			15 00 00 00 00 00 02 E3 0B
			15 00 00 00 00 00 02 E4 1D
			15 00 00 00 00 00 02 E5 1E
			15 00 00 00 00 00 02 E6 20
			15 00 00 00 00 00 02 E7 25
			15 00 00 00 00 00 02 E8 2C
			15 00 00 00 00 00 02 E9 6C
			15 00 00 00 00 00 02 EA 73
			15 00 00 00 00 00 02 EB 92
			15 00 00 00 00 00 02 EC A1
			15 00 00 00 00 00 02 ED A8
			15 00 00 00 00 00 02 EE A0
			15 00 00 00 00 00 02 EF A2
			15 00 00 00 00 00 02 F0 97
			15 00 00 00 00 00 02 F1 8F
			15 00 00 00 00 00 02 F2 8B
			15 00 00 00 00 00 02 F3 8A
			15 00 00 00 00 00 02 F4 7B
			15 00 00 00 00 00 02 F5 36
			15 00 00 00 00 00 02 F6 38
			15 00 00 00 00 00 02 F7 3A
			15 00 00 00 00 00 02 F8 3C
			15 00 00 00 00 00 02 F9 3F
			15 00 00 00 00 00 02 FA 42
			15 00 00 00 00 00 02 FB 44
			15 00 00 00 00 00 02 FC 46
			15 00 00 00 00 00 02 FD 47
			15 00 00 00 00 00 02 FE 00
			15 01 00 00 00 00 02 FF 00
			];
		lge,comfort-view-cmds-step8 = [
			//----R Gamma Register----
			//34
			15 00 00 00 00 00 02 83 AA
			15 00 00 00 00 00 02 84 11
			15 00 00 00 00 00 02 C0 00
			15 00 00 00 00 00 02 C1 0D
			15 00 00 00 00 00 02 C2 13
			15 00 00 00 00 00 02 C3 1B
			15 00 00 00 00 00 02 C4 23
			15 00 00 00 00 00 02 C5 2A
			15 00 00 00 00 00 02 C6 31
			15 00 00 00 00 00 02 C7 3B
			15 00 00 00 00 00 02 C8 44
			15 00 00 00 00 00 02 C9 9C
			15 00 00 00 00 00 02 CA A4
			15 00 00 00 00 00 02 CB C2
			15 00 00 00 00 00 02 CC D0
			15 00 00 00 00 00 02 CD DA
			15 00 00 00 00 00 02 CE DE
			15 00 00 00 00 00 02 CF E1
			15 00 00 00 00 00 02 D0 E8
			15 00 00 00 00 00 02 D1 FD
			15 00 00 00 00 00 02 D2 12
			15 00 00 00 00 00 02 D3 35
			15 00 00 00 00 00 02 D4 3F
			15 00 00 00 00 00 02 D5 AA
			15 00 00 00 00 00 02 D6 B2
			15 00 00 00 00 00 02 D7 BB
			15 00 00 00 00 00 02 D8 C2
			15 00 00 00 00 00 02 D9 CE
			15 00 00 00 00 00 02 DA DA
			15 00 00 00 00 00 02 DB E8
			15 00 00 00 00 00 02 DC FA
			15 00 00 00 00 00 02 DD FF
			15 00 00 00 00 00 02 DE 00
			15 01 00 00 00 00 02 DF 0E
			//34
			15 00 00 00 00 00 02 E0 00
			15 00 00 00 00 00 02 E1 0D
			15 00 00 00 00 00 02 E2 13
			15 00 00 00 00 00 02 E3 1B
			15 00 00 00 00 00 02 E4 23
			15 00 00 00 00 00 02 E5 2A
			15 00 00 00 00 00 02 E6 31
			15 00 00 00 00 00 02 E7 3B
			15 00 00 00 00 00 02 E8 44
			15 00 00 00 00 00 02 E9 9C
			15 00 00 00 00 00 02 EA A4
			15 00 00 00 00 00 02 EB C2
			15 00 00 00 00 00 02 EC D0
			15 00 00 00 00 00 02 ED DA
			15 00 00 00 00 00 02 EE DE
			15 00 00 00 00 00 02 EF E1
			15 00 00 00 00 00 02 F0 E8
			15 00 00 00 00 00 02 F1 FD
			15 00 00 00 00 00 02 F2 12
			15 00 00 00 00 00 02 F3 35
			15 00 00 00 00 00 02 F4 3F
			15 00 00 00 00 00 02 F5 AA
			15 00 00 00 00 00 02 F6 B2
			15 00 00 00 00 00 02 F7 BB
			15 00 00 00 00 00 02 F8 C2
			15 00 00 00 00 00 02 F9 CE
			15 00 00 00 00 00 02 FA DA
			15 00 00 00 00 00 02 FB E8
			15 00 00 00 00 00 02 FC FA
			15 00 00 00 00 00 02 FD FF
			15 00 00 00 00 00 02 FE 00
			15 00 00 00 00 00 02 FF 0E
			//----G Gamma Register---
			15 00 00 00 00 00 02 83 BB
			15 01 00 00 00 00 02 84 22
			//32
			15 00 00 00 00 00 02 C0 00
			15 00 00 00 00 00 02 C1 06
			15 00 00 00 00 00 02 C2 0C
			15 00 00 00 00 00 02 C3 13
			15 00 00 00 00 00 02 C4 1A
			15 00 00 00 00 00 02 C5 21
			15 00 00 00 00 00 02 C6 2A
			15 00 00 00 00 00 02 C7 31
			15 00 00 00 00 00 02 C8 3A
			15 00 00 00 00 00 02 C9 87
			15 00 00 00 00 00 02 CA 8F
			15 00 00 00 00 00 02 CB AB
			15 00 00 00 00 00 02 CC BA
			15 00 00 00 00 00 02 CD C1
			15 00 00 00 00 00 02 CE BF
			15 00 00 00 00 00 02 CF C1
			15 00 00 00 00 00 02 D0 BE
			15 00 00 00 00 00 02 D1 C1
			15 00 00 00 00 00 02 D2 C7
			15 00 00 00 00 00 02 D3 D2
			15 00 00 00 00 00 02 D4 CA
			15 00 00 00 00 00 02 D5 62
			15 00 00 00 00 00 02 D6 65
			15 00 00 00 00 00 02 D7 69
			15 00 00 00 00 00 02 D8 6D
			15 00 00 00 00 00 02 D9 70
			15 00 00 00 00 00 02 DA 74
			15 00 00 00 00 00 02 DB 78
			15 00 00 00 00 00 02 DC 7C
			15 00 00 00 00 00 02 DD 7F
			15 00 00 00 00 00 02 DE 00
			15 01 00 00 00 00 02 DF 00
			//34
			15 00 00 00 00 00 02 E0 00
			15 00 00 00 00 00 02 E1 06
			15 00 00 00 00 00 02 E2 0C
			15 00 00 00 00 00 02 E3 13
			15 00 00 00 00 00 02 E4 1A
			15 00 00 00 00 00 02 E5 21
			15 00 00 00 00 00 02 E6 2A
			15 00 00 00 00 00 02 E7 31
			15 00 00 00 00 00 02 E8 3A
			15 00 00 00 00 00 02 E9 87
			15 00 00 00 00 00 02 EA 8F
			15 00 00 00 00 00 02 EB AB
			15 00 00 00 00 00 02 EC BA
			15 00 00 00 00 00 02 ED C1
			15 00 00 00 00 00 02 EE BF
			15 00 00 00 00 00 02 EF C1
			15 00 00 00 00 00 02 F0 BE
			15 00 00 00 00 00 02 F1 C1
			15 00 00 00 00 00 02 F2 C7
			15 00 00 00 00 00 02 F3 D2
			15 00 00 00 00 00 02 F4 CA
			15 00 00 00 00 00 02 F5 62
			15 00 00 00 00 00 02 F6 65
			15 00 00 00 00 00 02 F7 69
			15 00 00 00 00 00 02 F8 6D
			15 00 00 00 00 00 02 F9 70
			15 00 00 00 00 00 02 FA 74
			15 00 00 00 00 00 02 FB 78
			15 00 00 00 00 00 02 FC 7C
			15 00 00 00 00 00 02 FD 7F
			15 00 00 00 00 00 02 FE 00
			15 00 00 00 00 00 02 FF 00
			//----B Gamma Register---
			15 00 00 00 00 00 02 83 CC
			15 01 00 00 00 00 02 84 33
			//32
			15 00 00 00 00 00 02 C0 00
			15 00 00 00 00 00 02 C1 02
			15 00 00 00 00 00 02 C2 03
			15 00 00 00 00 00 02 C3 04
			15 00 00 00 00 00 02 C4 10
			15 00 00 00 00 00 02 C5 18
			15 00 00 00 00 00 02 C6 23
			15 00 00 00 00 00 02 C7 23
			15 00 00 00 00 00 02 C8 2A
			15 00 00 00 00 00 02 C9 62
			15 00 00 00 00 00 02 CA 6A
			15 00 00 00 00 00 02 CB 88
			15 00 00 00 00 00 02 CC 97
			15 00 00 00 00 00 02 CD 9C
			15 00 00 00 00 00 02 CE 94
			15 00 00 00 00 00 02 CF 96
			15 00 00 00 00 00 02 D0 88
			15 00 00 00 00 00 02 D1 7B
			15 00 00 00 00 00 02 D2 75
			15 00 00 00 00 00 02 D3 71
			15 00 00 00 00 00 02 D4 5F
			15 00 00 00 00 00 02 D5 27
			15 00 00 00 00 00 02 D6 29
			15 00 00 00 00 00 02 D7 2B
			15 00 00 00 00 00 02 D8 2D
			15 00 00 00 00 00 02 D9 2F
			15 00 00 00 00 00 02 DA 31
			15 00 00 00 00 00 02 DB 33
			15 00 00 00 00 00 02 DC 35
			15 00 00 00 00 00 02 DD 36
			15 00 00 00 00 00 02 DE 00
			15 01 00 00 00 00 02 DF 00
			//32
			15 00 00 00 00 00 02 E0 00
			15 00 00 00 00 00 02 E1 02
			15 00 00 00 00 00 02 E2 03
			15 00 00 00 00 00 02 E3 04
			15 00 00 00 00 00 02 E4 10
			15 00 00 00 00 00 02 E5 18
			15 00 00 00 00 00 02 E6 23
			15 00 00 00 00 00 02 E7 23
			15 00 00 00 00 00 02 E8 2A
			15 00 00 00 00 00 02 E9 62
			15 00 00 00 00 00 02 EA 6A
			15 00 00 00 00 00 02 EB 88
			15 00 00 00 00 00 02 EC 97
			15 00 00 00 00 00 02 ED 9C
			15 00 00 00 00 00 02 EE 94
			15 00 00 00 00 00 02 EF 96
			15 00 00 00 00 00 02 F0 88
			15 00 00 00 00 00 02 F1 7B
			15 00 00 00 00 00 02 F2 75
			15 00 00 00 00 00 02 F3 71
			15 00 00 00 00 00 02 F4 5F
			15 00 00 00 00 00 02 F5 27
			15 00 00 00 00 00 02 F6 29
			15 00 00 00 00 00 02 F7 2B
			15 00 00 00 00 00 02 F8 2D
			15 00 00 00 00 00 02 F9 2F
			15 00 00 00 00 00 02 FA 31
			15 00 00 00 00 00 02 FB 33
			15 00 00 00 00 00 02 FC 35
			15 00 00 00 00 00 02 FD 36
			15 00 00 00 00 00 02 FE 00
			15 01 00 00 00 00 02 FF 00
			];
		lge,comfort-view-cmds-step9 = [
			//----R Gamma Register----
			//34
			15 00 00 00 00 00 02 83 AA
			15 00 00 00 00 00 02 84 11
			15 00 00 00 00 00 02 C0 00
			15 00 00 00 00 00 02 C1 01
			15 00 00 00 00 00 02 C2 08
			15 00 00 00 00 00 02 C3 12
			15 00 00 00 00 00 02 C4 1C
			15 00 00 00 00 00 02 C5 27
			15 00 00 00 00 00 02 C6 30
			15 00 00 00 00 00 02 C7 39
			15 00 00 00 00 00 02 C8 44
			15 00 00 00 00 00 02 C9 9B
			15 00 00 00 00 00 02 CA A4
			15 00 00 00 00 00 02 CB C3
			15 00 00 00 00 00 02 CC D0
			15 00 00 00 00 00 02 CD DB
			15 00 00 00 00 00 02 CE DE
			15 00 00 00 00 00 02 CF E0
			15 00 00 00 00 00 02 D0 E8
			15 00 00 00 00 00 02 D1 FE
			15 00 00 00 00 00 02 D2 13
			15 00 00 00 00 00 02 D3 39
			15 00 00 00 00 00 02 D4 41
			15 00 00 00 00 00 02 D5 AB
			15 00 00 00 00 00 02 D6 B2
			15 00 00 00 00 00 02 D7 BA
			15 00 00 00 00 00 02 D8 C3
			15 00 00 00 00 00 02 D9 CE
			15 00 00 00 00 00 02 DA DC
			15 00 00 00 00 00 02 DB E7
			15 00 00 00 00 00 02 DC FA
			15 00 00 00 00 00 02 DD FF
			15 00 00 00 00 00 02 DE 00
			15 01 00 00 00 00 02 DF 0E
			//34
			15 00 00 00 00 00 02 E0 00
			15 00 00 00 00 00 02 E1 01
			15 00 00 00 00 00 02 E2 08
			15 00 00 00 00 00 02 E3 12
			15 00 00 00 00 00 02 E4 1C
			15 00 00 00 00 00 02 E5 27
			15 00 00 00 00 00 02 E6 30
			15 00 00 00 00 00 02 E7 39
			15 00 00 00 00 00 02 E8 44
			15 00 00 00 00 00 02 E9 9B
			15 00 00 00 00 00 02 EA A4
			15 00 00 00 00 00 02 EB C3
			15 00 00 00 00 00 02 EC D0
			15 00 00 00 00 00 02 ED DB
			15 00 00 00 00 00 02 EE DE
			15 00 00 00 00 00 02 EF E0
			15 00 00 00 00 00 02 F0 E8
			15 00 00 00 00 00 02 F1 FE
			15 00 00 00 00 00 02 F2 13
			15 00 00 00 00 00 02 F3 39
			15 00 00 00 00 00 02 F4 41
			15 00 00 00 00 00 02 F5 AB
			15 00 00 00 00 00 02 F6 B2
			15 00 00 00 00 00 02 F7 BA
			15 00 00 00 00 00 02 F8 C3
			15 00 00 00 00 00 02 F9 CE
			15 00 00 00 00 00 02 FA DC
			15 00 00 00 00 00 02 FB E7
			15 00 00 00 00 00 02 FC FA
			15 00 00 00 00 00 02 FD FF
			15 00 00 00 00 00 02 FE 00
			15 00 00 00 00 00 02 FF 0E
			//----G Gamma Register---
			15 00 00 00 00 00 02 83 BB
			15 01 00 00 00 00 02 84 22
			//32
			15 00 00 00 00 00 02 C0 00
			15 00 00 00 00 00 02 C1 0C
			15 00 00 00 00 00 02 C2 0F
			15 00 00 00 00 00 02 C3 14
			15 00 00 00 00 00 02 C4 1A
			15 00 00 00 00 00 02 C5 20
			15 00 00 00 00 00 02 C6 28
			15 00 00 00 00 00 02 C7 2F
			15 00 00 00 00 00 02 C8 37
			15 00 00 00 00 00 02 C9 80
			15 00 00 00 00 00 02 CA 89
			15 00 00 00 00 00 02 CB A4
			15 00 00 00 00 00 02 CC B1
			15 00 00 00 00 00 02 CD B8
			15 00 00 00 00 00 02 CE B3
			15 00 00 00 00 00 02 CF B5
			15 00 00 00 00 00 02 D0 AF
			15 00 00 00 00 00 02 D1 AC
			15 00 00 00 00 00 02 D2 AE
			15 00 00 00 00 00 02 D3 B3
			15 00 00 00 00 00 02 D4 A8
			15 00 00 00 00 00 02 D5 4F
			15 00 00 00 00 00 02 D6 52
			15 00 00 00 00 00 02 D7 55
			15 00 00 00 00 00 02 D8 58
			15 00 00 00 00 00 02 D9 5B
			15 00 00 00 00 00 02 DA 5E
			15 00 00 00 00 00 02 DB 61
			15 00 00 00 00 00 02 DC 64
			15 00 00 00 00 00 02 DD 66
			15 00 00 00 00 00 02 DE 00
			15 01 00 00 00 00 02 DF 00
			//34
			15 00 00 00 00 00 02 E0 00
			15 00 00 00 00 00 02 E1 0C
			15 00 00 00 00 00 02 E2 0F
			15 00 00 00 00 00 02 E3 14
			15 00 00 00 00 00 02 E4 1A
			15 00 00 00 00 00 02 E5 20
			15 00 00 00 00 00 02 E6 28
			15 00 00 00 00 00 02 E7 2F
			15 00 00 00 00 00 02 E8 37
			15 00 00 00 00 00 02 E9 80
			15 00 00 00 00 00 02 EA 89
			15 00 00 00 00 00 02 EB A4
			15 00 00 00 00 00 02 EC B1
			15 00 00 00 00 00 02 ED B8
			15 00 00 00 00 00 02 EE B3
			15 00 00 00 00 00 02 EF B5
			15 00 00 00 00 00 02 F0 AF
			15 00 00 00 00 00 02 F1 AC
			15 00 00 00 00 00 02 F2 AE
			15 00 00 00 00 00 02 F3 B3
			15 00 00 00 00 00 02 F4 A8
			15 00 00 00 00 00 02 F5 4F
			15 00 00 00 00 00 02 F6 52
			15 00 00 00 00 00 02 F7 55
			15 00 00 00 00 00 02 F8 58
			15 00 00 00 00 00 02 F9 5B
			15 00 00 00 00 00 02 FA 5E
			15 00 00 00 00 00 02 FB 61
			15 00 00 00 00 00 02 FC 64
			15 00 00 00 00 00 02 FD 66
			15 00 00 00 00 00 02 FE 00
			15 00 00 00 00 00 02 FF 00
			//----B Gamma Register---
			15 00 00 00 00 00 02 83 CC
			15 01 00 00 00 00 02 84 33
			//32
			15 00 00 00 00 00 02 C0 00
			15 00 00 00 00 00 02 C1 01
			15 00 00 00 00 00 02 C2 04
			15 00 00 00 00 00 02 C3 08
			15 00 00 00 00 00 02 C4 0D
			15 00 00 00 00 00 02 C5 1A
			15 00 00 00 00 00 02 C6 20
			15 00 00 00 00 00 02 C7 24
			15 00 00 00 00 00 02 C8 25
			15 00 00 00 00 00 02 C9 54
			15 00 00 00 00 00 02 CA 5A
			15 00 00 00 00 00 02 CB 75
			15 00 00 00 00 00 02 CC 82
			15 00 00 00 00 00 02 CD 87
			15 00 00 00 00 00 02 CE 7B
			15 00 00 00 00 00 02 CF 7D
			15 00 00 00 00 00 02 D0 6B
			15 00 00 00 00 00 02 D1 57
			15 00 00 00 00 00 02 D2 4D
			15 00 00 00 00 00 02 D3 44
			15 00 00 00 00 00 02 D4 30
			15 00 00 00 00 00 02 D5 0E
			15 00 00 00 00 00 02 D6 0F
			15 00 00 00 00 00 02 D7 11
			15 00 00 00 00 00 02 D8 12
			15 00 00 00 00 00 02 D9 14
			15 00 00 00 00 00 02 DA 15
			15 00 00 00 00 00 02 DB 17
			15 00 00 00 00 00 02 DC 19
			15 00 00 00 00 00 02 DD 19
			15 00 00 00 00 00 02 DE 00
			15 01 00 00 00 00 02 DF 00
			//32
			15 00 00 00 00 00 02 E0 00
			15 00 00 00 00 00 02 E1 01
			15 00 00 00 00 00 02 E2 04
			15 00 00 00 00 00 02 E3 08
			15 00 00 00 00 00 02 E4 0D
			15 00 00 00 00 00 02 E5 1A
			15 00 00 00 00 00 02 E6 20
			15 00 00 00 00 00 02 E7 24
			15 00 00 00 00 00 02 E8 25
			15 00 00 00 00 00 02 E9 54
			15 00 00 00 00 00 02 EA 5A
			15 00 00 00 00 00 02 EB 75
			15 00 00 00 00 00 02 EC 82
			15 00 00 00 00 00 02 ED 87
			15 00 00 00 00 00 02 EE 7B
			15 00 00 00 00 00 02 EF 7D
			15 00 00 00 00 00 02 F0 6B
			15 00 00 00 00 00 02 F1 57
			15 00 00 00 00 00 02 F2 4D
			15 00 00 00 00 00 02 F3 44
			15 00 00 00 00 00 02 F4 30
			15 00 00 00 00 00 02 F5 0E
			15 00 00 00 00 00 02 F6 0F
			15 00 00 00 00 00 02 F7 11
			15 00 00 00 00 00 02 F8 12
			15 00 00 00 00 00 02 F9 14
			15 00 00 00 00 00 02 FA 15
			15 00 00 00 00 00 02 FB 17
			15 00 00 00 00 00 02 FC 19
			15 00 00 00 00 00 02 FD 19
			15 00 00 00 00 00 02 FE 00
			15 01 00 00 00 00 02 FF 00
			];
		lge,comfort-view-cmds-step10 = [
			//----R Gamma Register----
			//34
			15 00 00 00 00 00 02 83 AA
			15 00 00 00 00 00 02 84 11
			15 00 00 00 00 00 02 C0 00
			15 00 00 00 00 00 02 C1 01
			15 00 00 00 00 00 02 C2 08
			15 00 00 00 00 00 02 C3 12
			15 00 00 00 00 00 02 C4 20
			15 00 00 00 00 00 02 C5 2A
			15 00 00 00 00 00 02 C6 30
			15 00 00 00 00 00 02 C7 3A
			15 00 00 00 00 00 02 C8 43
			15 00 00 00 00 00 02 C9 99
			15 00 00 00 00 00 02 CA A4
			15 00 00 00 00 00 02 CB C2
			15 00 00 00 00 00 02 CC D0
			15 00 00 00 00 00 02 CD DB
			15 00 00 00 00 00 02 CE DE
			15 00 00 00 00 00 02 CF E0
			15 00 00 00 00 00 02 D0 E8
			15 00 00 00 00 00 02 D1 FE
			15 00 00 00 00 00 02 D2 13
			15 00 00 00 00 00 02 D3 38
			15 00 00 00 00 00 02 D4 3F
			15 00 00 00 00 00 02 D5 AA
			15 00 00 00 00 00 02 D6 B2
			15 00 00 00 00 00 02 D7 BA
			15 00 00 00 00 00 02 D8 C5
			15 00 00 00 00 00 02 D9 D0
			15 00 00 00 00 00 02 DA DA
			15 00 00 00 00 00 02 DB EA
			15 00 00 00 00 00 02 DC FE
			15 00 00 00 00 00 02 DD FF
			15 00 00 00 00 00 02 DE 00
			15 01 00 00 00 00 02 DF 0E
			//34
			15 00 00 00 00 00 02 E0 00
			15 00 00 00 00 00 02 E1 01
			15 00 00 00 00 00 02 E2 08
			15 00 00 00 00 00 02 E3 12
			15 00 00 00 00 00 02 E4 20
			15 00 00 00 00 00 02 E5 2A
			15 00 00 00 00 00 02 E6 30
			15 00 00 00 00 00 02 E7 3A
			15 00 00 00 00 00 02 E8 43
			15 00 00 00 00 00 02 E9 99
			15 00 00 00 00 00 02 EA A4
			15 00 00 00 00 00 02 EB C2
			15 00 00 00 00 00 02 EC D0
			15 00 00 00 00 00 02 ED DB
			15 00 00 00 00 00 02 EE DE
			15 00 00 00 00 00 02 EF E0
			15 00 00 00 00 00 02 F0 E8
			15 00 00 00 00 00 02 F1 FE
			15 00 00 00 00 00 02 F2 13
			15 00 00 00 00 00 02 F3 38
			15 00 00 00 00 00 02 F4 3F
			15 00 00 00 00 00 02 F5 AA
			15 00 00 00 00 00 02 F6 B2
			15 00 00 00 00 00 02 F7 BA
			15 00 00 00 00 00 02 F8 C5
			15 00 00 00 00 00 02 F9 D0
			15 00 00 00 00 00 02 FA DA
			15 00 00 00 00 00 02 FB EA
			15 00 00 00 00 00 02 FC FE
			15 00 00 00 00 00 02 FD FF
			15 00 00 00 00 00 02 FE 00
			15 00 00 00 00 00 02 FF 0E
			//----G Gamma Register---
			15 00 00 00 00 00 02 83 BB
			15 01 00 00 00 00 02 84 22
			//32
			15 00 00 00 00 00 02 C0 00
			15 00 00 00 00 00 02 C1 0C
			15 00 00 00 00 00 02 C2 0F
			15 00 00 00 00 00 02 C3 13
			15 00 00 00 00 00 02 C4 17
			15 00 00 00 00 00 02 C5 1E
			15 00 00 00 00 00 02 C6 26
			15 00 00 00 00 00 02 C7 2D
			15 00 00 00 00 00 02 C8 35
			15 00 00 00 00 00 02 C9 7B
			15 00 00 00 00 00 02 CA 83
			15 00 00 00 00 00 02 CB 9D
			15 00 00 00 00 00 02 CC AD
			15 00 00 00 00 00 02 CD B0
			15 00 00 00 00 00 02 CE A9
			15 00 00 00 00 00 02 CF AB
			15 00 00 00 00 00 02 D0 A2
			15 00 00 00 00 00 02 D1 9C
			15 00 00 00 00 00 02 D2 9B
			15 00 00 00 00 00 02 D3 9C
			15 00 00 00 00 00 02 D4 8F
			15 00 00 00 00 00 02 D5 41
			15 00 00 00 00 00 02 D6 43
			15 00 00 00 00 00 02 D7 46
			15 00 00 00 00 00 02 D8 48
			15 00 00 00 00 00 02 D9 4B
			15 00 00 00 00 00 02 DA 4E
			15 00 00 00 00 00 02 DB 50
			15 00 00 00 00 00 02 DC 53
			15 00 00 00 00 00 02 DD 55
			15 00 00 00 00 00 02 DE 00
			15 01 00 00 00 00 02 DF 00
			//34
			15 00 00 00 00 00 02 E0 00
			15 00 00 00 00 00 02 E1 0C
			15 00 00 00 00 00 02 E2 0F
			15 00 00 00 00 00 02 E3 13
			15 00 00 00 00 00 02 E4 17
			15 00 00 00 00 00 02 E5 1E
			15 00 00 00 00 00 02 E6 26
			15 00 00 00 00 00 02 E7 2D
			15 00 00 00 00 00 02 E8 35
			15 00 00 00 00 00 02 E9 7B
			15 00 00 00 00 00 02 EA 83
			15 00 00 00 00 00 02 EB 9D
			15 00 00 00 00 00 02 EC AD
			15 00 00 00 00 00 02 ED B0
			15 00 00 00 00 00 02 EE A9
			15 00 00 00 00 00 02 EF AB
			15 00 00 00 00 00 02 F0 A2
			15 00 00 00 00 00 02 F1 9C
			15 00 00 00 00 00 02 F2 9B
			15 00 00 00 00 00 02 F3 9C
			15 00 00 00 00 00 02 F4 8F
			15 00 00 00 00 00 02 F5 41
			15 00 00 00 00 00 02 F6 43
			15 00 00 00 00 00 02 F7 46
			15 00 00 00 00 00 02 F8 48
			15 00 00 00 00 00 02 F9 4B
			15 00 00 00 00 00 02 FA 4E
			15 00 00 00 00 00 02 FB 50
			15 00 00 00 00 00 02 FC 53
			15 00 00 00 00 00 02 FD 55
			15 00 00 00 00 00 02 FE 00
			15 00 00 00 00 00 02 FF 00
			//----B Gamma Register---
			15 00 00 00 00 00 02 83 CC
			15 01 00 00 00 00 02 84 33
			//32
			15 00 00 00 00 00 02 C0 00
			15 00 00 00 00 00 02 C1 01
			15 00 00 00 00 00 02 C2 03
			15 00 00 00 00 00 02 C3 07
			15 00 00 00 00 00 02 C4 12
			15 00 00 00 00 00 02 C5 12
			15 00 00 00 00 00 02 C6 1C
			15 00 00 00 00 00 02 C7 1C
			15 00 00 00 00 00 02 C8 21
			15 00 00 00 00 00 02 C9 4E
			15 00 00 00 00 00 02 CA 4A
			15 00 00 00 00 00 02 CB 62
			15 00 00 00 00 00 02 CC 6E
			15 00 00 00 00 00 02 CD 71
			15 00 00 00 00 00 02 CE 63
			15 00 00 00 00 00 02 CF 65
			15 00 00 00 00 00 02 D0 50
			15 00 00 00 00 00 02 D1 37
			15 00 00 00 00 00 02 D2 2B
			15 00 00 00 00 00 02 D3 1E
			15 00 00 00 00 00 02 D4 08
			15 00 00 00 00 00 02 D5 00
			15 00 00 00 00 00 02 D6 00
			15 00 00 00 00 00 02 D7 00
			15 00 00 00 00 00 02 D8 00
			15 00 00 00 00 00 02 D9 00
			15 00 00 00 00 00 02 DA 00
			15 00 00 00 00 00 02 DB 00
			15 00 00 00 00 00 02 DC 02
			15 00 00 00 00 00 02 DD 02
			15 00 00 00 00 00 02 DE 00
			15 01 00 00 00 00 02 DF 00
			//32
			15 00 00 00 00 00 02 E0 00
			15 00 00 00 00 00 02 E1 01
			15 00 00 00 00 00 02 E2 03
			15 00 00 00 00 00 02 E3 07
			15 00 00 00 00 00 02 E4 12
			15 00 00 00 00 00 02 E5 12
			15 00 00 00 00 00 02 E6 1C
			15 00 00 00 00 00 02 E7 1C
			15 00 00 00 00 00 02 E8 21
			15 00 00 00 00 00 02 E9 4E
			15 00 00 00 00 00 02 EA 4A
			15 00 00 00 00 00 02 EB 62
			15 00 00 00 00 00 02 EC 6E
			15 00 00 00 00 00 02 ED 71
			15 00 00 00 00 00 02 EE 63
			15 00 00 00 00 00 02 EF 65
			15 00 00 00 00 00 02 F0 50
			15 00 00 00 00 00 02 F1 37
			15 00 00 00 00 00 02 F2 2B
			15 00 00 00 00 00 02 F3 1E
			15 00 00 00 00 00 02 F4 08
			15 00 00 00 00 00 02 F5 00
			15 00 00 00 00 00 02 F6 00
			15 00 00 00 00 00 02 F7 00
			15 00 00 00 00 00 02 F8 00
			15 00 00 00 00 00 02 F9 00
			15 00 00 00 00 00 02 FA 00
			15 00 00 00 00 00 02 FB 00
			15 00 00 00 00 00 02 FC 02
			15 00 00 00 00 00 02 FD 02
			15 00 00 00 00 00 02 FE 00
			15 01 00 00 00 00 02 FF 00
			];


		qcom,mdss-pan-physical-width-dimension = <108>;
		qcom,mdss-pan-physical-height-dimension = <172>;
		qcom,mdss-dsi-h-sync-pulse = <0>;
		qcom,mdss-dsi-traffic-mode = "non_burst_sync_event";
		qcom,mdss-dsi-lane-map = "lane_map_0123";
		qcom,mdss-dsi-bllp-eof-power-mode;
		qcom,mdss-dsi-bllp-power-mode;
		qcom,mdss-dsi-lane-0-state;
		qcom,mdss-dsi-lane-1-state;
		qcom,mdss-dsi-lane-2-state;
		qcom,mdss-dsi-lane-3-state;
		qcom,mdss-dsi-panel-timings = [F8 46 28 00 6E 6E 32 4B 48 03 04 00];	//958.3Mhz
		qcom,mdss-dsi-t-clk-post = <0x02>;
		qcom,mdss-dsi-t-clk-pre = <0x32>;
		qcom,mdss-dsi-dma-trigger = "trigger_sw";
		qcom,mdss-dsi-mdp-trigger = "none";
		qcom,off-cmds-dsi-state = "dsi_hs_mode";

		lge,blmap-size = <256>;
		lge,blmap = <
			   0   50   50   50   50   50   50   50   50   50       /*  0 ~   9*/
			  50   50   51   51   52   52   52   53   53   53       /* 10 ~  19*/
			  54   54   55   55   57   58   60   62   63   65       /* 20 ~  29*/
			  67   68   70   72   73   75   78   81   84   87       /* 30 ~  39*/
			  90   92   95   98  101  104  107  110  113  117       /* 40 ~  49*/
			 120  123  127  130  133  137  140  143  147  150       /* 50 ~  59*/
			 155  161  166  172  177  182  188  193  198  204       /* 60 ~  69*/
			 209  215  220  226  232  238  243  249  255  261       /* 70 ~  79*/
			 267  272  278  284  290  298  305  312  320  328       /* 80 ~  89*/
			 335  342  350  358  365  372  380  390  400  410       /* 90 ~  99*/
			 420  430  440  450  460  470  480  490  500  510       /*100 ~ 109*/
			 520  530  540  550  560  570  580  590  600  610       /*110 ~ 119*/
			 620  630  644  658  672  687  701  715  729  743       /*120 ~ 129*/
			 758  772  786  800  812  825  838  850  862  875       /*130 ~ 139*/
			 888  900  912  925  938  950  967  983 1000 1017       /*140 ~ 149*/
			1033 1050 1067 1083 1100 1117 1133 1150 1175 1201       /*150 ~ 159*/
			1226 1252 1277 1302 1328 1353 1378 1404 1429 1455       /*160 ~ 169*/
			1480 1490 1500 1510 1520 1530 1540 1550 1560 1570       /*170 ~ 179*/
			1580 1590 1600 1625 1650 1675 1700 1725 1750 1775       /*180 ~ 189*/
			1800 1825 1850 1875 1900 1922 1943 1965 1987 2008       /*190 ~ 199*/
			2030 2052 2073 2095 2117 2138 2160 2186 2212 2238       /*200 ~ 209*/
			2265 2291 2317 2343 2369 2395 2422 2448 2474 2500       /*210 ~ 219*/
			2525 2550 2575 2600 2625 2650 2675 2700 2725 2750       /*220 ~ 229*/
			2775 2800 2829 2858 2888 2917 2946 2975 3004 3033       /*230 ~ 239*/
			3062 3092 3121 3150 3183 3217 3250 3283 3317 3350       /*240 ~ 249*/
			3383 3417 3450 3483 3517 3550                           /*250 ~ 255*/
			>;
	};
};
