&mdss_mdp {
	dsi_cv1_tovis_td4100_hd_vid: qcom,mdss_dsi_cv1_tovis_td4100_hd_video{
		compatible = "qcom,mdss-dsi-panel";
		status = "disable";
		qcom,cont-splash-enabled;
		qcom,mdss-dsi-panel-name = "CV1 TOVIS TD4100 HD video mode dsi panel";
		qcom,mdss-dsi-panel-controller = <&mdss_dsi0>;
		qcom,mdss-dsi-panel-type = "dsi_video_mode";
		qcom,mdss-dsi-panel-destination = "display_1";
		qcom,mdss-dsi-panel-framerate = <60>;
		//qcom,mdss-dsi-force-clock-lane-hs;
		qcom,mdss-dsi-virtual-channel-id = <0>;
		qcom,mdss-dsi-stream = <0>;
		qcom,mdss-dsi-lp11-init;
		qcom,suspend-ulps-enabled;
		qcom,mdss-dsi-panel-width = <720>;
		qcom,mdss-dsi-panel-height = <1280>;
		qcom,mdss-dsi-h-front-porch = <84>;
		qcom,mdss-dsi-h-back-porch = <44>;
		qcom,mdss-dsi-h-pulse-width = <4>;
		qcom,mdss-dsi-h-sync-skew = <0>;
		qcom,mdss-dsi-v-front-porch = <127>;
		qcom,mdss-dsi-v-back-porch = <127>;
		qcom,mdss-dsi-v-pulse-width = <127>;
		qcom,mdss-dsi-h-left-border = <0>;
		qcom,mdss-dsi-h-right-border = <0>;
		qcom,mdss-dsi-v-top-border = <0>;
		qcom,mdss-dsi-v-bottom-border = <0>;
		qcom,mdss-pan-physical-width-dimension = <62>;
		qcom,mdss-pan-physical-height-dimension = <110>;
		qcom,mdss-dsi-bpp = <24>;
		qcom,mdss-dsi-color-order = "rgb_swap_rgb";
		qcom,mdss-dsi-underflow-color = <0>;
		qcom,mdss-dsi-border-color = <0>;
		qcom,mdss-dsi-post-panel-on-command = [
			05 01 00 00 78 00 02
			11 00
			05 01 00 00 14 00 02
			29 00
		];
		qcom,mdss-dsi-off-command = [
			05 01 00 00 00 00 02
			28 00
			05 01 00 00 78 00 02
			10 00
		];

		lge,comfort-view-cmds-step1 = [ /*Step1 6950K*/
			29 01 00 00 00 00 02 B0 04 // MACP
			15 01 00 00 00 00 02 C8 11
			29 01 00 00 00 00 13 C9 00 00 00 00 00 FC 00 00 00 00 00 AF 00 00 00 00 00 8A
			29 01 00 00 00 00 05 CA 1D FC FC FC
			29 01 00 00 00 00 02 B0 03 // MACP
		];
		lge,comfort-view-cmds-step2 = [ /*Step2 6650*/
			29 01 00 00 00 00 02 B0 04 // MACP
			15 01 00 00 00 00 02 C8 11
			29 01 00 00 00 00 13 C9 00 00 00 00 00 FC 00 00 00 00 00 A8 00 00 00 00 00 75
			29 01 00 00 00 00 05 CA 1D FC FC FC
			29 01 00 00 00 00 02 B0 03 // MACP
		];
		lge,comfort-view-cmds-step3 = [ /*Step3 6300*/
			29 01 00 00 00 00 02 B0 04 // MACP
			15 01 00 00 00 00 02 C8 11
			29 01 00 00 00 00 13 C9 00 00 00 00 00 FC 00 00 00 00 00 A0 00 00 00 00 00 53
			29 01 00 00 00 00 05 CA 1D FC FC FC
			29 01 00 00 00 00 02 B0 03 // MACP
		];
		lge,comfort-view-cmds-step4 = [ /*Step4 6000*/
			29 01 00 00 00 00 02 B0 04 // MACP
			15 01 00 00 00 00 02 C8 11
			29 01 00 00 00 00 13 C9 00 00 00 00 00 FC 00 00 00 00 00 99 00 00 00 00 00 34
			29 01 00 00 00 00 05 CA 1D FC FC FC
			29 01 00 00 00 00 02 B0 03 // MACP
		];
		lge,comfort-view-cmds-step5 = [ /*Step5 5650*/
			29 01 00 00 00 00 02 B0 04 // MACP
			15 01 00 00 00 00 02 C8 11
			29 01 00 00 00 00 13 C9 00 00 00 00 00 FC 00 00 00 00 00 90 00 00 00 00 00 08
			29 01 00 00 00 00 05 CA 1D FC FC FC
			29 01 00 00 00 00 02 B0 03 // MACP

		];
		lge,comfort-view-cmds-step6 = [ /*Step6 5300*/
			29 01 00 00 00 00 02 B0 04 // MACP
			15 01 00 00 00 00 02 C8 11
			29 01 00 00 00 00 13 C9 00 00 00 00 00 FC 00 00 00 00 00 90 00 00 00 00 00 00
			29 01 00 00 00 00 05 CA 1D FC F2 C5
			29 01 00 00 00 00 02 B0 03 // MACP
		];
		lge,comfort-view-cmds-step7 = [ /*Step7 5150*/
			29 01 00 00 00 00 02 B0 04 // MACP
			15 01 00 00 00 00 02 C8 11
			29 01 00 00 00 00 13 C9 00 00 00 00 00 FC 00 00 00 00 00 90 00 00 00 00 00 00
			29 01 00 00 00 00 05 CA 1D FC E8 A7
			29 01 00 00 00 00 02 B0 03 // MACP
		];
		lge,comfort-view-cmds-step8 = [ /*Step8 5000*/
			29 01 00 00 00 00 02 B0 04 // MACP
			15 01 00 00 00 00 02 C8 11
			29 01 00 00 00 00 13 C9 00 00 00 00 00 FC 00 00 00 00 00 90 00 00 00 00 00 00
			29 01 00 00 00 00 05 CA 1D FC DE 88
			29 01 00 00 00 00 02 B0 03 // MACP
		];
		lge,comfort-view-cmds-step9 = [ /*Step9 4800*/
			29 01 00 00 00 00 02 B0 04 // MACP
			15 01 00 00 00 00 02 C8 11
			29 01 00 00 00 00 13 C9 00 00 00 00 00 FC 00 00 00 00 00 90 00 00 00 00 00 00
			29 01 00 00 00 00 05 CA 1D FC D3 5E
			29 01 00 00 00 00 02 B0 03 // MACP
		];
		lge,comfort-view-cmds-step10 = [ /*Step10 4650*/
			29 01 00 00 00 00 02 B0 04 // MACP
			15 01 00 00 00 00 02 C8 11
			29 01 00 00 00 00 13 C9 00 00 00 00 00 FC 00 00 00 00 00 90 00 00 00 00 00 00
			29 01 00 00 00 00 05 CA 1D FC C8 3F
			29 01 00 00 00 00 02 B0 03 // MACP
		];

		lge,comfort-view-cmds-off = [	// NORMAL
			29 01 00 00 00 00 02 B0 04 // MACP
			15 01 00 00 00 00 02 C8 11
			29 01 00 00 00 00 13 C9 00 00 00 00 00 FC 00 00 00 00 00 FC 00 00 00 00 00 FC
			29 01 00 00 00 00 05 CA 1C FC FC FC
			29 01 00 00 00 00 02 B0 03 // MACP
		];

		lge,comfort-view-cmds-state = "dsi_hs_mode";

		qcom,mdss-dsi-on-command-state = "dsi_lp_mode";
		qcom,mdss-dsi-off-command-state = "dsi_hs_mode";
		qcom,mdss-dsi-h-sync-pulse = <1>;
		qcom,mdss-dsi-traffic-mode = "non_burst_sync_pulse";
		qcom,mdss-dsi-lane-map = "lane_map_0123";
		qcom,mdss-dsi-bllp-eof-power-mode;
		qcom,mdss-dsi-bllp-power-mode;
		qcom,mdss-dsi-lane-0-state;
		qcom,mdss-dsi-lane-1-state;
		qcom,mdss-dsi-lane-2-state;
		qcom,mdss-dsi-lane-3-state;
		qcom,mdss-dsi-tx-eot-append;
		qcom,mdss-dsi-panel-timings = [94 20 14 00 46 48 1A 24 18 03 04 00];
		qcom,mdss-dsi-t-clk-post = <0x04>;
		qcom,mdss-dsi-t-clk-pre = <0x1D>;

		//The following feature "none" and "trigger_sw" are the same in video mode.
		//The feature used any option of TE signal in command mode.
		qcom,mdss-dsi-dma-trigger = "trigger_sw";	//default "trigger_sw"
		qcom,mdss-dsi-mdp-trigger = "trigger_sw";	//default "trigger_sw"

		qcom,mdss-dsi-bl-min-level = <1>;
		qcom,mdss-dsi-bl-max-level = <255>;
		qcom,mdss-dsi-bl-pmic-control-type = "bl_ctrl_wled";
		qcom,mdss-dsi-reset-sequence = <0 10>, <1 130>;

		lge,blmap-size = <256>;
		lge,blmap = <   0 32 32 32 32 32 32 32 32 32			/* 0 ~ 9 */
			32 34 36 38 40 42 44 46 49 51				/* 10 ~ 19 */
			52 54 57 59 61 63 65 67 69 71				/* 20 ~ 29 */
			74 75 77 79 82 84 86 88 90 92				/* 30 ~ 39 */
			94 97 98 100 102 105 107 109 110 113			/* 40 ~ 49 */
			115 117 119 121 123 125 127 130 132 133			/* 50 ~ 59 */
			136 143 150 157 165 172 179 187 194 201			/* 60 ~ 69 */
			209 216 224 231 238 246 253 260 268 275			/* 70 ~ 79 */
			282 290 297 305 312 318 326 333 340 348			/* 80 ~ 89 */
			355 362 370 377 385 392 399 407 414 421			/* 90 ~ 99 */
			429 436 443 451 458 466 473 480 488 500			/* 100 ~ 109 */
			514 527 541 554 568 581 594 607 621 635			/* 110 ~ 119 */
			648 661 674 688 701 715 728 742 755 768			/* 120 ~ 129 */
			782 795 809 822 835 848 862 875 889 903			/* 130 ~ 139 */
			915 929 942 956 969 983 995 1009 1023 1036		/* 140 ~ 149 */
			1050 1063 1076 1089 1103 1116 1130 1144 1163 1183	/* 150 ~ 159 */
			1203 1244 1263 1284 1304 1325 1345 1365 1386 1406	/* 160 ~ 169 */
			1426 1446 1467 1488 1507 1528 1548 1569 1589 1609	/* 170 ~ 179 */
			1630 1650 1670 1690 1711 1732 1751 1772 1792 1813 	/* 180 ~ 189 */
			1833 1853 1874 1894 1914 1935 1955 1976 1995 2016 	/* 190 ~ 199 */
			2036 2057 2077 2097 2118 2138 2159 2186 2213 2241	/* 200 ~ 209 */
			2316 2345 2372 2400 2429 2456 2485 2513 2540 2569	/* 210 ~ 219 */
			2597 2625 2653 2681 2709 2737 2766 2793 2821 2850	/* 220 ~ 229 */
			2877 2906 2934 2962 2990 3018 3046 3074 3103 3130	/* 230 ~ 239 */
			3158 3187 3214 3243 3271 3298 3327 3355 3383 3411	/* 240 ~ 249 */
			3439 3467 3495 3524 3551 3580 >;			/* 250 ~ 255 */
	};
};
