/*
 * Copyright (c) 2015-2016, The Linux Foundation. All rights reserved.
 *
 * This program is free software; you can redistribute it and/or modify
 * it under the terms of the GNU General Public License version 2 and
 * only version 2 as published by the Free Software Foundation.
 *
 * This program is distributed in the hope that it will be useful,
 * but WITHOUT ANY WARRANTY; without even the implied warranty of
 * MERCHANTABILITY or FITNESS FOR A PARTICULAR PURPOSE.  See the
 * GNU General Public License for more details.
 */

&int_codec {
    qcom,msm-hs-micbias-type = "internal";
    qcom,dac-reset-gpio = <&tlmm 60 0>;
    qcom,dac-hifi-ldo-comp = <&pm8953_gpios 6 0x0>;
    lge,msm-mbhc-extn-cable = <1>;
};

&soc {
	qcom,iris-fm {
		compatible = "qcom,iris_fm";
		qcom,fm-sw-gpio = <&tlmm 33 0>;
		xm,vdd_fm_sw-supply = <&pm8953_l10>;
	};
};

&pm8953_diangu_dig {
    lge,cdc-gnd-cfilt;
};