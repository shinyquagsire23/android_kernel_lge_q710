/* Copyright (c) 2014-2015, The Linux Foundation. All rights reserved.
 *
 * This program is free software; you can redistribute it and/or modify
 * it under the terms of the GNU General Public License version 2 and
 * only version 2 as published by the Free Software Foundation.
 *
 * This program is distributed in the hope that it will be useful,
 * but WITHOUT ANY WARRANTY; without even the implied warranty of
 * MERCHANTABILITY or FITNESS FOR A PARTICULAR PURPOSE.  See the
 * GNU General Public License for more details.
 */

/*---------------------------------------------------------------------------
 * This file is autogenerated file using gcdb parser. Please do not edit it.
 * Update input XML file to add a new entry or update variable in this file
 * VERSION = "1.0"
 *---------------------------------------------------------------------------*/
&mdss_mdp {
	dsi_boe_incell_ili9881h_hd_vid: qcom,mdss_dsi_boe_ili9881h_hd_video {
		compatible = "qcom,mdss-dsi-panel";
		status = "ok";
		qcom,cont-splash-enabled;
		qcom,mdss-dsi-panel-name = "BOE INCELL ILI9881H HD video mode dsi panel";
		qcom,mdss-dsi-panel-controller = <&mdss_dsi0>;
		qcom,mdss-dsi-panel-type = "dsi_video_mode";
		qcom,mdss-dsi-panel-destination = "display_1";
		qcom,mdss-dsi-virtual-channel-id = <0>;
		qcom,mdss-dsi-stream = <0>;
		qcom,mdss-dsi-panel-framerate = <60>;
		qcom,mdss-dsi-bpp = <24>;
		qcom,mdss-dsi-panel-width = <720>;
		qcom,mdss-dsi-panel-height = <1440>;
		qcom,mdss-dsi-h-front-porch = <68>;
		qcom,mdss-dsi-h-back-porch = <72>;
		qcom,mdss-dsi-h-pulse-width = <4>;
		qcom,mdss-dsi-h-sync-skew = <0>;
		qcom,mdss-dsi-v-front-porch = <216>;
		qcom,mdss-dsi-v-back-porch = <20>;
		qcom,mdss-dsi-v-pulse-width = <4>;

		qcom,mdss-dsi-h-left-border = <0>;
		qcom,mdss-dsi-h-right-border = <0>;
		qcom,mdss-dsi-v-top-border = <0>;
		qcom,mdss-dsi-v-bottom-border = <0>;

		qcom,mdss-dsi-underflow-color = <0xff>;
		qcom,mdss-dsi-border-color = <0>;

		qcom,mdss-pan-physical-width-dimension = <64>;
		qcom,mdss-pan-physical-height-dimension = <129>;

		qcom,mdss-dsi-on-command = [
			29 01 00 00 00 00 04 FF 98 81 01
			29 01 00 00 00 00 02 2D 60
			29 01 00 00 00 00 02 00 48
			29 01 00 00 00 00 02 01 33
			29 01 00 00 00 00 02 02 97
			29 01 00 00 00 00 02 03 05
			29 01 00 00 00 00 02 08 86
			29 01 00 00 00 00 02 09 01
			29 01 00 00 00 00 02 0a 73
			29 01 00 00 00 00 02 0b 00
			29 01 00 00 00 00 02 0c ff
			29 01 00 00 00 00 02 0d ff
			29 01 00 00 00 00 02 0e 05
			29 01 00 00 00 00 02 0f 05
			29 01 00 00 00 00 02 12 06
			29 01 00 00 00 00 02 28 48
			29 01 00 00 00 00 02 29 86
			29 01 00 00 00 00 02 31 07
			29 01 00 00 00 00 02 32 02    //GCL_R
			29 01 00 00 00 00 02 33 00    //VSD_R
			29 01 00 00 00 00 02 34 15    //CLK2
			29 01 00 00 00 00 02 35 17    //CLK4
			29 01 00 00 00 00 02 36 11    //CLK6
			29 01 00 00 00 00 02 37 13    //CLK8
			29 01 00 00 00 00 02 38 2a    //VGL_R
			29 01 00 00 00 00 02 39 06    //GCH_R
			29 01 00 00 00 00 02 3a 01    //VDS_R
			29 01 00 00 00 00 02 3b 09    //STV2
			29 01 00 00 00 00 02 3c 0b    //STV4
			29 01 00 00 00 00 02 3d 07
			29 01 00 00 00 00 02 3e 07
			29 01 00 00 00 00 02 3f 07
			29 01 00 00 00 00 02 40 07
			29 01 00 00 00 00 02 41 07
			29 01 00 00 00 00 02 42 07
			29 01 00 00 00 00 02 43 07
			29 01 00 00 00 00 02 44 07
			29 01 00 00 00 00 02 45 07
			29 01 00 00 00 00 02 46 07
			29 01 00 00 00 00 02 47 07
			29 01 00 00 00 00 02 48 02      //GCL_L
			29 01 00 00 00 00 02 49 00      //VSD_L
			29 01 00 00 00 00 02 4a 14      //CLK1
			29 01 00 00 00 00 02 4b 16      //CLK3
			29 01 00 00 00 00 02 4c 10      //CLK5
			29 01 00 00 00 00 02 4d 12      //CLK7
			29 01 00 00 00 00 02 4e 2a      //VGL_L
			29 01 00 00 00 00 02 4f 06      //GCH_L
			29 01 00 00 00 00 02 50 01      //VDS_L
			29 01 00 00 00 00 02 51 08      //STV1
			29 01 00 00 00 00 02 52 0a      //STV3
			29 01 00 00 00 00 02 53 07
			29 01 00 00 00 00 02 54 07
			29 01 00 00 00 00 02 55 07
			29 01 00 00 00 00 02 56 07
			29 01 00 00 00 00 02 57 07
			29 01 00 00 00 00 02 58 07
			29 01 00 00 00 00 02 59 07
			29 01 00 00 00 00 02 5a 07
			29 01 00 00 00 00 02 5b 07
			29 01 00 00 00 00 02 5c 07
			29 01 00 00 00 00 02 61 07
			29 01 00 00 00 00 02 62 02
			29 01 00 00 00 00 02 63 00
			29 01 00 00 00 00 02 64 12
			29 01 00 00 00 00 02 65 10
			29 01 00 00 00 00 02 66 16
			29 01 00 00 00 00 02 67 14
			29 01 00 00 00 00 02 68 2a
			29 01 00 00 00 00 02 69 06       //GCH_R  BW
			29 01 00 00 00 00 02 6a 01
			29 01 00 00 00 00 02 6b 0a
			29 01 00 00 00 00 02 6c 08
			29 01 00 00 00 00 02 6d 07
			29 01 00 00 00 00 02 6e 07
			29 01 00 00 00 00 02 6f 07
			29 01 00 00 00 00 02 70 07
			29 01 00 00 00 00 02 71 07
			29 01 00 00 00 00 02 72 07
			29 01 00 00 00 00 02 73 07
			29 01 00 00 00 00 02 74 07
			29 01 00 00 00 00 02 75 07
			29 01 00 00 00 00 02 76 07
			29 01 00 00 00 00 02 77 07
			29 01 00 00 00 00 02 78 02
			29 01 00 00 00 00 02 79 00
			29 01 00 00 00 00 02 7a 13
			29 01 00 00 00 00 02 7b 11
			29 01 00 00 00 00 02 7c 17
			29 01 00 00 00 00 02 7d 15
			29 01 00 00 00 00 02 7e 2a
			29 01 00 00 00 00 02 7f 06       //GCH_L  BW
			29 01 00 00 00 00 02 80 01
			29 01 00 00 00 00 02 81 0b
			29 01 00 00 00 00 02 82 09
			29 01 00 00 00 00 02 83 07
			29 01 00 00 00 00 02 84 07
			29 01 00 00 00 00 02 85 07
			29 01 00 00 00 00 02 86 07
			29 01 00 00 00 00 02 87 07
			29 01 00 00 00 00 02 88 07
			29 01 00 00 00 00 02 89 07
			29 01 00 00 00 00 02 8a 07
			29 01 00 00 00 00 02 8b 07
			29 01 00 00 00 00 02 8c 07
			29 01 00 00 00 00 02 a0 01
			29 01 00 00 00 00 02 a1 82
			29 01 00 00 00 00 02 a2 25
			29 01 00 00 00 00 02 a7 82
			29 01 00 00 00 00 02 a8 82
			29 01 00 00 00 00 02 a9 25
			29 01 00 00 00 00 02 aa 25
			29 01 00 00 00 00 02 b0 34
			29 01 00 00 00 00 02 b2 04
			29 01 00 00 00 00 02 b9 00	//20
			29 01 00 00 00 00 02 ba 01
			29 01 00 00 00 00 02 c1 10
			29 01 00 00 00 00 02 d0 01
			29 01 00 00 00 00 02 d1 00
			29 01 00 00 00 00 02 e2 00
			29 01 00 00 00 00 02 e6 22
			29 01 00 00 00 00 02 ea 00
			29 01 00 00 00 00 02 FC 09 //VHsync
			29 01 00 00 00 00 04 FF 98 81 02
			29 01 00 00 00 00 02 5B 00
			29 01 00 00 00 00 02 0B 00
			29 01 00 00 00 00 02 4D 4E
			29 01 00 00 00 00 02 4E 00
			29 01 00 00 00 00 04 FF 98 81 05
			29 01 00 00 00 00 02 63 97 //GVDDN  5.5V
			29 01 00 00 00 00 02 64 97 //GVDDP  -5.5V
			29 01 00 00 00 00 02 68 65 //VGHO   12V
			29 01 00 00 00 00 02 69 7F //VGH
			29 01 00 00 00 00 02 6A C9 //VGLO  -14V  D3
			29 01 00 00 00 00 02 6B CF //VGL
			29 01 00 00 00 00 04 FF 98 81 08
			29 01 00 00 00 00 1C E0 00 24 4D 6F A0 50 CC F1 21 48 95 89 BF F2 22 AA 54 8E B3 E0 FF 06 36 6F 9F 03 EC
			29 01 00 00 00 00 1C E1 00 24 4D 6F A0 50 CC F1 21 48 95 89 BF F2 22 AA 54 8E B3 E0 FF 06 36 6F 9F 03 EC
			29 01 00 00 00 00 04 FF 98 81 06
			29 01 00 00 00 00 02 C2 04
			29 01 00 00 00 00 02 D6 85
			29 01 00 00 00 00 02 D2 01
			29 01 00 00 00 00 02 D1 01
			29 01 00 00 00 00 02 D0 4A
			29 01 00 00 00 00 02 11 03
			29 01 00 00 00 00 02 13 45  //+0.25%
			29 01 00 00 00 00 02 14 41
			29 01 00 00 00 00 02 15 F1  //-0.25%
			29 01 00 00 00 00 02 16 40
			29 01 00 00 00 00 02 17 48
			29 01 00 00 00 00 02 18 3B
			29 01 00 00 00 00 04 FF 98 81 0E
			29 01 00 00 00 00 02 11 90
			29 01 00 00 00 00 02 13 0A
			29 01 00 00 00 00 02 00 A0
			29 01 00 00 00 00 04 FF 98 81 00	// CE enable
			29 01 00 00 00 00 02 55 90
			29 01 00 00 00 00 04 FF 98 81 00 //Page0
			05 01 00 00 78 00 02 11 00
			05 01 00 00 14 00 02 29 00
		];
		qcom,mdss-dsi-off-command = [
			05 01 00 00 14 00 02 28 00
			05 01 00 00 78 00 02 10 00
		];

		lge,mdss-dsi-extra-command-names = "lpwg-on";

		lge,mdss-dsi-extra-command-lpwg-on = [
			29 01 00 00 00 00 04 FF 98 81 01
			29 01 00 00 00 00 02 2D 60
			29 01 00 00 00 00 02 00 48
			29 01 00 00 00 00 02 01 33
			29 01 00 00 00 00 02 02 97
			29 01 00 00 00 00 02 03 05
			29 01 00 00 00 00 02 08 86
			29 01 00 00 00 00 02 09 01
			29 01 00 00 00 00 02 0a 73
			29 01 00 00 00 00 02 0b 00
			29 01 00 00 00 00 02 0c ff
			29 01 00 00 00 00 02 0d ff
			29 01 00 00 00 00 02 0e 05
			29 01 00 00 00 00 02 0f 05
			29 01 00 00 00 00 02 12 06
			29 01 00 00 00 00 02 28 48
			29 01 00 00 00 00 02 29 86
			29 01 00 00 00 00 02 31 07
			29 01 00 00 00 00 02 32 02    //GCL_R
			29 01 00 00 00 00 02 33 00    //VSD_R
			29 01 00 00 00 00 02 34 15    //CLK2
			29 01 00 00 00 00 02 35 17    //CLK4
			29 01 00 00 00 00 02 36 11    //CLK6
			29 01 00 00 00 00 02 37 13    //CLK8
			29 01 00 00 00 00 02 38 2a    //VGL_R
			29 01 00 00 00 00 02 39 06    //GCH_R
			29 01 00 00 00 00 02 3a 01    //VDS_R
			29 01 00 00 00 00 02 3b 09    //STV2
			29 01 00 00 00 00 02 3c 0b    //STV4
			29 01 00 00 00 00 02 3d 07
			29 01 00 00 00 00 02 3e 07
			29 01 00 00 00 00 02 3f 07
			29 01 00 00 00 00 02 40 07
			29 01 00 00 00 00 02 41 07
			29 01 00 00 00 00 02 42 07
			29 01 00 00 00 00 02 43 07
			29 01 00 00 00 00 02 44 07
			29 01 00 00 00 00 02 45 07
			29 01 00 00 00 00 02 46 07
			29 01 00 00 00 00 02 47 07
			29 01 00 00 00 00 02 48 02      //GCL_L
			29 01 00 00 00 00 02 49 00      //VSD_L
			29 01 00 00 00 00 02 4a 14      //CLK1
			29 01 00 00 00 00 02 4b 16      //CLK3
			29 01 00 00 00 00 02 4c 10      //CLK5
			29 01 00 00 00 00 02 4d 12      //CLK7
			29 01 00 00 00 00 02 4e 2a      //VGL_L
			29 01 00 00 00 00 02 4f 06      //GCH_L
			29 01 00 00 00 00 02 50 01      //VDS_L
			29 01 00 00 00 00 02 51 08      //STV1
			29 01 00 00 00 00 02 52 0a      //STV3
			29 01 00 00 00 00 02 53 07
			29 01 00 00 00 00 02 54 07
			29 01 00 00 00 00 02 55 07
			29 01 00 00 00 00 02 56 07
			29 01 00 00 00 00 02 57 07
			29 01 00 00 00 00 02 58 07
			29 01 00 00 00 00 02 59 07
			29 01 00 00 00 00 02 5a 07
			29 01 00 00 00 00 02 5b 07
			29 01 00 00 00 00 02 5c 07
			29 01 00 00 00 00 02 61 07
			29 01 00 00 00 00 02 62 02
			29 01 00 00 00 00 02 63 00
			29 01 00 00 00 00 02 64 12
			29 01 00 00 00 00 02 65 10
			29 01 00 00 00 00 02 66 16
			29 01 00 00 00 00 02 67 14
			29 01 00 00 00 00 02 68 2a
			29 01 00 00 00 00 02 69 06       //GCH_R  BW
			29 01 00 00 00 00 02 6a 01
			29 01 00 00 00 00 02 6b 0a
			29 01 00 00 00 00 02 6c 08
			29 01 00 00 00 00 02 6d 07
			29 01 00 00 00 00 02 6e 07
			29 01 00 00 00 00 02 6f 07
			29 01 00 00 00 00 02 70 07
			29 01 00 00 00 00 02 71 07
			29 01 00 00 00 00 02 72 07
			29 01 00 00 00 00 02 73 07
			29 01 00 00 00 00 02 74 07
			29 01 00 00 00 00 02 75 07
			29 01 00 00 00 00 02 76 07
			29 01 00 00 00 00 02 77 07
			29 01 00 00 00 00 02 78 02
			29 01 00 00 00 00 02 79 00
			29 01 00 00 00 00 02 7a 13
			29 01 00 00 00 00 02 7b 11
			29 01 00 00 00 00 02 7c 17
			29 01 00 00 00 00 02 7d 15
			29 01 00 00 00 00 02 7e 2a
			29 01 00 00 00 00 02 7f 06       //GCH_L  BW
			29 01 00 00 00 00 02 80 01
			29 01 00 00 00 00 02 81 0b
			29 01 00 00 00 00 02 82 09
			29 01 00 00 00 00 02 83 07
			29 01 00 00 00 00 02 84 07
			29 01 00 00 00 00 02 85 07
			29 01 00 00 00 00 02 86 07
			29 01 00 00 00 00 02 87 07
			29 01 00 00 00 00 02 88 07
			29 01 00 00 00 00 02 89 07
			29 01 00 00 00 00 02 8a 07
			29 01 00 00 00 00 02 8b 07
			29 01 00 00 00 00 02 8c 07
			29 01 00 00 00 00 02 a0 01
			29 01 00 00 00 00 02 a1 82
			29 01 00 00 00 00 02 a2 25
			29 01 00 00 00 00 02 a7 82
			29 01 00 00 00 00 02 a8 82
			29 01 00 00 00 00 02 a9 25
			29 01 00 00 00 00 02 aa 25
			29 01 00 00 00 00 02 b0 34
			29 01 00 00 00 00 02 b2 04
			29 01 00 00 00 00 02 b9 00	//20
			29 01 00 00 00 00 02 ba 01
			29 01 00 00 00 00 02 c1 10
			29 01 00 00 00 00 02 d0 01
			29 01 00 00 00 00 02 d1 00
			29 01 00 00 00 00 02 e2 00
			29 01 00 00 00 00 02 e6 22
			29 01 00 00 00 00 02 ea 00
			29 01 00 00 00 00 02 FC 09 //VHsync
			29 01 00 00 00 00 04 FF 98 81 02
			29 01 00 00 00 00 02 5B 00
			29 01 00 00 00 00 02 0B 00
			29 01 00 00 00 00 02 4D 4E
			29 01 00 00 00 00 02 4E 00
			29 01 00 00 00 00 04 FF 98 81 05
			29 01 00 00 00 00 02 63 97 //GVDDN  5.5V
			29 01 00 00 00 00 02 64 97 //GVDDP  -5.5V
			29 01 00 00 00 00 02 68 65 //VGHO   12V
			29 01 00 00 00 00 02 69 7F //VGH
			29 01 00 00 00 00 02 6A C9 //VGLO  -14V  D3
			29 01 00 00 00 00 02 6B CF //VGL
			29 01 00 00 00 00 04 FF 98 81 08
			29 01 00 00 00 00 1C E0 00 24 4D 6F A0 50 CC F1 21 48 95 89 BF F2 22 AA 54 8E B3 E0 FF 06 36 6F 9F 03 EC
			29 01 00 00 00 00 1C E1 00 24 4D 6F A0 50 CC F1 21 48 95 89 BF F2 22 AA 54 8E B3 E0 FF 06 36 6F 9F 03 EC
			29 01 00 00 00 00 04 FF 98 81 06
			29 01 00 00 00 00 02 C2 04
			29 01 00 00 00 00 02 D6 85
			29 01 00 00 00 00 02 D2 01
			29 01 00 00 00 00 02 D1 01
			29 01 00 00 00 00 02 D0 4A
			29 01 00 00 00 00 02 11 03
			29 01 00 00 00 00 02 13 45  //+0.25%
			29 01 00 00 00 00 02 14 41
			29 01 00 00 00 00 02 15 F1  //-0.25%
			29 01 00 00 00 00 02 16 40
			29 01 00 00 00 00 02 17 48
			29 01 00 00 00 00 02 18 3B
			29 01 00 00 00 00 04 FF 98 81 0E
			29 01 00 00 00 00 02 11 90
			29 01 00 00 00 00 02 13 0A
			29 01 00 00 00 00 02 00 A0
			29 01 00 00 00 00 04 FF 98 81 00	// CE enable
			29 01 00 00 00 00 02 55 90
			29 01 00 00 00 00 04 FF 98 81 00 //Page0
		];
		lge,mdss-dsi-extra-command-state-lpwg-on = "dsi_lp_mode";

		qcom,mdss-dsi-on-command-state = "dsi_lp_mode";
		qcom,mdss-dsi-off-command-state = "dsi_lp_mode";
		qcom,mdss-dsi-reset-sequence = <0 0>, <0 0>, <1 120>;
		qcom,mdss-dsi-lp11-init;
		qcom,mdss-dsi-post-init-delay = <4>;
		qcom,mdss-dsi-h-sync-pulse = <1>;
		qcom,mdss-dsi-traffic-mode = "non_burst_sync_pulse";
		qcom,mdss-dsi-lane-map = "lane_map_0123";
		qcom,mdss-dsi-dma-trigger = "trigger_sw";
		qcom,mdss-dsi-mdp-trigger = "none";
		qcom,mdss-dsi-color-order = "rgb_swap_rgb";
		qcom,mdss-dsi-bllp-eof-power-mode;
		qcom,mdss-dsi-bllp-power-mode;
		qcom,mdss-dsi-tx-eot-append;
		qcom,mdss-dsi-lane-0-state;
		qcom,mdss-dsi-lane-1-state;
		qcom,mdss-dsi-lane-2-state;
		qcom,mdss-dsi-lane-3-state;

		qcom,mdss-dsi-panel-timings-phy-v2 = [
			1F 1C 05 06 03 03 04 a0
			1F 1C 05 06 03 03 04 a0
			1F 1C 05 06 03 03 04 a0
			1F 1C 05 06 03 03 04 a0
			1F 10 05 06 03 03 04 a0
		];
		qcom,mdss-dsi-t-clk-post = <0x0A>;
		qcom,mdss-dsi-t-clk-pre = <0x21>;

		qcom,mdss-dsi-bl-min-level = <1>;
		qcom,mdss-dsi-bl-max-level = <255>;
		qcom,mdss-dsi-bl-pmic-control-type = "bl_ctrl_wled";

		lge,blmap-size = <256>;
		lge,blmap = <
			0 33 33 33 33 33 33 33 33 33					/* 0 ~ 9 */
			33 35 37 40 42 44 47 49 52 54					/* 10 ~ 19 */
			56 59 61 63 66 68 71 73 75 78					/* 20 ~ 29 */
			80 82 85 87 90 92 94 97 99 102					/* 30 ~ 39 */
			104 106 109 111 113 116 118 121 123 125				/* 40 ~ 49 */
			128 130 132 135 137 140 142 144 147 149				/* 50 ~ 59 */
			152 160 169 177 186 194 203 211 220 228				/* 60 ~ 69 */
			237 245 254 262 271 279 288 296 305 313				/* 70 ~ 79 */
			322 330 339 347 356 365 373 382 390 399				/* 80 ~ 89 */
			407 416 424 433 441 450 458 467 475 484				/* 90 ~ 99 */
			492 501 509 518 526 535 543 552 561 576				/* 100 ~ 109 */
			591 606 621 636 652 667 682 697 712 728				/* 110 ~ 119 */
			743 758 773 788 803 819 834 849 864 879				/* 120 ~ 129 */
			895 910 925 940 955 970 986 1001 1016 1031			/* 130 ~ 139 */
			1046 1062 1077 1092 1107 1122 1137 1153 1168 1183		/* 140 ~ 149 */
			1198 1213 1229 1244 1259 1274 1289 1305 1328 1352		/* 150 ~ 159 */
			1375 1399 1422 1446 1469 1493 1516 1540 1563 1587		/* 160 ~ 169 */
			1610 1634 1657 1681 1705 1728 1752 1775 1799 1822		/* 170 ~ 179 */
			1846 1869 1893 1916 1940 1963 1987 2010 2034 2057		/* 180 ~ 189 */
			2081 2105 2128 2152 2175 2199 2222 2246 2269 2293		/* 190 ~ 199 */
			2316 2340 2363 2387 2410 2434 2458 2491 2524 2558		/* 200 ~ 209 */
			2591 2625 2658 2691 2725 2758 2792 2825 2858 2892		/* 210 ~ 219 */
			2925 2959 2992 3025 3059 3092 3126 3159 3192 3226		/* 220 ~ 229 */
			3259 3293 3326 3360 3393 3426 3460 3493 3527 3560		/* 230 ~ 239 */
			3593 3627 3660 3694 3727 3760 3794 3827 3861 3894		/* 240 ~ 249 */
			3927 3961 3994 4028 4061 4095					/* 250 ~ 255 */
		>;
	};
};
