/* Copyright (c) 2014, The Linux Foundation. All rights reserved.
 *
 * This program is free software; you can redistribute it and/or modify
 * it under the terms of the GNU General Public License version 2 and
 * only version 2 as published by the Free Software Foundation.
 *
 * This program is distributed in the hope that it will be useful,
 * but WITHOUT ANY WARRANTY; without even the implied warranty of
 * MERCHANTABILITY or FITNESS FOR A PARTICULAR PURPOSE.  See the
 * GNU General Public License for more details.
 */

&soc{
	spi_1: spi@78b5000 {	// [Modified] QUP_BASE address for BLSP1 QUP1 (ref. AP datasheet, This model use BLSP-1 QUP1)
     /* [1. SPI Information]
      *  1) BLSP #1
      *  2) GPIO #0~3
      */
		status = "ok";
		compatible = "qcom,spi-qup-v2";

		// [Fixed] Address, size for slave chips.
		#address-cells = <1>;
		#size-cells = <0>;

		/* [Fixed] Resister region names referenced in reg.
			"spi_physical"     : Physical address of controller register blocks.
			when use BAM mode, add "spi_bam_physical"
			"spi_bam_physical" : Physical address of BAM controller.
			Keep the same names. */
		reg-names = "spi_physical";

		/* [Modified] Modify the reg field as below to add BLSP BAM base address (ref. AP datasheet)
			First Row is BLSP_QUP base address, size,
			Second Row is BAM address, size. */
		reg = <0x78b5000 0x600> ;

		/* [Fixed] Interrupt resource names referenced in interrupts.
			"spi_irq"     : QUP-core interrupt
			when use BAM mode, add "spi_bam_irq"
			"spi_bam_irq" : BAM interrupt
			Keep the same names. */
		interrupt-names = "spi_irq";

		/* [Modified] Replace the interrupt filed. (ref. AP datasheet)
			First Field  : SPI interrupt, keep 0
			Second Field : Interrupt #
			Third Field  : Trigger type, keep 0
			First Row is BLSP_QUP base, Second Row is BAM. */
		interrupts = <0 95 0>;

		// [Fixed] Specifies maximum SPI clock frequency of AP(50 MHz). (ref. QCT SPI datasheet)
		spi-max-frequency = <50000000>;

		// [Modified] BLSP bus master ID. (ref. AP datasheet)
		qcom,master-id = <86>;

		// [Fixed] Set up the clocks, Keep the same names.
		clock-names = "iface_clk", "core_clk";
		/* [Modified]
			Add node to BLSP# AHB clock,
			Add node to QUP Core clock (BLSP# QUP#)
			Note : In clock QUP Core is label #1 to X. So QUP0 would be label as QUP1. */
		clocks = <&clock_gcc clk_gcc_blsp1_ahb_clk>, <&clock_gcc clk_gcc_blsp1_qup1_spi_apps_clk>;

		// [Fixed] When use pinctrl, enable.
		qcom,use-pinctrl;
		// [Fixed] Must contain "spi_default" and "spi_sleep" if pinctrl is to be used. Keep the same names.
		pinctrl-names = "spi_default","spi_sleep";
		/* [Fixed] List of phandles, each pointing at a pin configuration node within a pin controller.
			The list of names to assign states, List entry 0 defines the name for integer state ID 0... */
		pinctrl-0 = <&spi_isdbt_active>;
		pinctrl-1 = <&spi_isdbt_suspend>;

		// [Fixed] QUP uses infinite-mode. set zero
		qcom,infinite-mode = <0>;
		// [Fixed] When use BAM mode, enable.
		/*qcom,use-bam;*/
		// [Fixed] Version register exists.
		/*qcom,ver-reg-exists;*/
		// [Modified] Add consumer and producer pipes (ref. AP datasheet)
		/*qcom,bam-consumer-pipe-index = <10>;*/
		/*qcom,bam-producer-pipe-index = <11>;*/
	};
};


&spi_1 {
	isdbt@0 {
		compatible = "fci,fc8180-spi";  // [Fixed] Should be "fci,fc8180-spi".
		reg = <0>;
		interrupt-parent = <&tlmm>; // [Fixed] msm_gpio is the parent (msm8937)
		interrupts = <13 0x0>; // [Modified] Set INT GPIO, first # is gpio #, second flag keep it 0.

		// [Fixed] Specifies maximum SPI clock frequency of isdbt chipset(38.4 MHz). (ref. FC8180 datasheet)
		spi-max-frequency = <38400000>;

		/* [Fixed] The list of names to assign states, List entry 0,1,2... define the name for integer state ID 0,1,2...
			- isdbt_pin_active : set to pinctrl-0 list (set to active)
			- isdbt_pin_sleep : set to pinctrl-1 list (set to sleep) 	*/
		pinctrl-names = "isdbt_pin_active", "isdbt_pin_sleep";

		/* [Modified] The pin cofig lists can be for control pin.
			- pinctrl-0 : active state
			- pinctrl-1 : active sleep(suspend)
			The pin config lists shall be defined in the "(model)-pinctrl.dtsi" file
			The control pins lists are interrupt(isdbt_int), enable(isdbt_en),
				FM/DMB antenna swtiching(isdbt_ant), LNA gain control & enable(isdbt_lna), LDO enable(isdbt_ldo)
			Additional items may vary depending on model schematic. */
		pinctrl-0 = <&isdbt_int_active>, <&isdbt_en_active>, <&isdbt_lna_active>/*, <&isdbt_ant_active>*/;
		pinctrl-1 = <&isdbt_int_suspend>, <&isdbt_en_suspend>, <&isdbt_lna_suspend>/*, <&isdbt_ant_suspend>*/;

		/* [Modified] first is parents's node, second # is gpio #, third flag keep it 0. */
		isdbt_fc8180,en-gpio = <&tlmm 114 0x00>;
		//isdbt_fc8180,lna-ctrl-gpio = <&tlmm ?? 0x00>;
		isdbt_fc8180,lna-en-gpio = <&tlmm 50 0x00>;
		//isdbt_fc8180,ldo-en-gpio = <&tlmm ?? 0x00>;

		/* [Modified] when use DMB_EN & LDO_EN same gpio, change below property to 1 */
		isdbt-en-lna-en-same-gpio = <0>;

		/* [Modified] when use ant switching, ant active mode (high(1) or low(0)), ant-gpio.
		ant-sw-apio should be isdbt ant's Gpio number */
		//isdbt_fc8180,ant-gpio = <&tlmm ?? 0x00>;
		ant-active-mode = <0>;

		/* [Modified] set hw configure here
			when use pmic clk buffer, change use-xtal to 0, and set xtal-freq value, interface-freq(SPI interface clk) inter value in kHz.  */
		use-xtal = <0>;
		xtal-freq = <19200>;
     		interface-freq = <19200>;

		/* [Modified] when using pmic clk buffer,
			 you should check which clock buffer used for isdbt device */
		clock-names = "isdbt_xo";
		clocks = <&clock_gcc clk_rf_clk2>;

		/* [Modified] When use ldo for RFSW, change ctrl-ant-sw-ldo to 1, and ant-sw-supply set the appropriate chipset & power function such as <&pm8953_l10>
				If no use case, change ctrl-ant-sw-ldo to 0, and ant-sw-supply set such as <&chipset#_l??>*/
		ctrl-ant-sw-ldo = <0>;
		//ant-sw-ldo-supply = <&chipset#_l??>;

		/* [Modified] when use ldo for LDO_IN, change ctrl-dmb-ldo to 1, and dmb-ldo-supply set the appropriate chipset & power function such as <&pm8953_l10>
				If no use case, change ctrl-dmb-ldo to 0, and dmb-ldo-supply set such as <&chipset#_l??>*/
		ctrl-isdbt-ldo = <0>;
		//isdbt-ldo-supply = <&chipset#_l??>

		/* [Modified] when use ldo for LNA(U1800), change ctrl-lna-ldo to 1, and lna-ldo-supply set the appropriate chipset & power function such as <&pm8953_l10>
				If no use case, change ctrl-lna-ldo to 0, and lna-ldo-supply set such as <&chipset#_l??>*/
		ctrl-lna-ldo = <0>;
		//lna-ldo-supply = <&chipset#_l??>;
	};
};
